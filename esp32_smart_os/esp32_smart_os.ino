/*
 * ─────────────────────────────────────────────────────────────
 *  Smart OS — XIAO ESP32-S3 Sense firmware (v3.32 final)
 *  Hardware: Seeed XIAO ESP32-S3 Sense + 0.91" SSD1306 OLED
 *
 *  ⚠ DO NOT lower config.frame_size in initCamera() below FRAMESIZE_UXGA.
 *    The esp32-camera driver allocates DMA buffers at init and does NOT
 *    resize them when set_framesize() is called later. AI/Timelapse modes
 *    request UXGA at runtime — initializing at VGA causes a DMA buffer
 *    overflow on the first non-Guard photo capture, resetting the chip.
 *    We init at UXGA, then drop the sensor to VGA for default operation.
 *
 *  Six modes navigated via PDM-microphone tap detection (no buttons):
 *    Guard / AI Assist / Classic / Voice / Timelapse / IT Support / Settings
 *
 *  Tap conventions:
 *    1× tap → scroll / single action     2× tap → confirm / enter mode
 *    3× tap → exit / unlock              auto-lock after 40 s idle
 *
 *  Companion VPS backend: vps_backend/main.py (FastAPI + Gemini + Telegram).
 *
 *  Configuration (WiFi, VPS host, ports) is in wifi_config.h.
 *  See wifi_config.example.h for the template.
 *
 *  Flashing: USB-OTG bootloader, hold BOOT, tap RESET, release BOOT,
 *  then upload from Arduino IDE. (No OTA in this build — TinyUSB and
 *  ArduinoOTA conflicted on the S3.)
 * ─────────────────────────────────────────────────────────────
 */

#include <WiFi.h>
#include <HTTPClient.h>
#include <ArduinoJson.h>
#include "esp_camera.h"
#include "soc/soc.h"
#include "soc/rtc_cntl_reg.h"
#include <Wire.h>
#include <U8g2lib.h>
#include <ESP_I2S.h>
#include <USB.h>
#include <USBHIDKeyboard.h>

// Local credentials (gitignored). See wifi_config.example.h.
#include "wifi_config.h"

// ───── Network config ─────
const char*  ssid       = WIFI_SSID;
const char*  password   = WIFI_PASSWORD;
const String vps_host   = VPS_HOST;
const int    vps_port   = VPS_PORT;
const String stream_url = "/upload_stream";
const String ai_url     = "/ask_ai";

#define BUTTON_PIN          GPIO_NUM_0   // sadece deep sleep wakeup icin
#define SCREEN_SAVER_MS     30000
#define GUARD_FRAME_DELAY   500
#define MAX_FRAMES_PSRAM    15
#define MAX_FRAMES_RAM      6
#define UPLOAD_TIMEOUT_MS   60000
#define AI_TIMEOUT_MS       35000

// ================= TAP ALGILAMA =================
// Delta tabanli: ani yukselmeleri algilar
// Kural: 1 tap = aksiyon, 2 tap = gir/geri, 3 tap = kilit ac/iptal
// Kilit sistemi: 3 tap ile acilir, 40sn hareketsizlikte kapanir
#define TAP_DELTA_MIN    1100   // ani yukselme esigi (kalibrasyona gore: tap ~2490, ambient ~876)
#define TAP_DEBOUNCE_MS   110   // iki tap arasi minimum sure (120→110: hizli cift-tap icin)
#define TAP_EMIT_DELAY    420   // son taptan bu sure sonra karar ver (700→420: cok daha cabuK)
#define TAP_COOLDOWN_MS   350   // event sonrasi bekleme (600→350: hizli ardisik komutlar icin)
#define TAP_LOCK_MS      40000  // bu kadar inaktiflik sonrasi otomatik kilit

// ================= SES KOMUTLARI =================
// Sadece VOICE_MODE icinde aktif — arka planda calismaz, tap sistemi etkilenmez
#define VOICE_CAPTURE_SECS 2     // Komut icin ses kayit suresi (saniye)

// ================= TİMELAPSE =================
// Doldur-bosalt: PSRAM dolar → VPS'e batch gonder → temizle → devam
// Gonderim her zaman capture SONRASINDA yapilir (asla esit zamanda degil)
#define TL_INTERVAL_MS    (2UL * 60UL * 1000UL)  // 2 dakika aralik
#define TL_BATCH_FRAMES   20                       // PSRAM'da max frame (UXGA icin guvenli)
#define TL_FRAMESIZE      FRAMESIZE_UXGA           // maksimum kalite
#define TL_OLED_ON_MS     6000                     // frame sonrasi OLED bu kadar acik kalir
#define VOICE_SAMPLES      (16000 * VOICE_CAPTURE_SECS)   // 32000 sample
#define VOICE_BYTES        (VOICE_SAMPLES * 2)             // 64000 byte (16-bit)
#define VOICE_WAV_TOTAL    (VOICE_BYTES + 44)              // WAV header = 44 byte

// ================= OLED =================
U8G2_SSD1306_128X32_UNIVISION_F_HW_I2C u8g2(U8G2_R0, U8X8_PIN_NONE, 6, 5);

// ================= MİKROFON =================
I2SClass micI2S;
static int16_t micBuf[160];
uint32_t g_tapFlash = 0;

// ================= KAMERA PINLERİ =================
#define PWDN_GPIO_NUM  -1
#define RESET_GPIO_NUM -1
#define XCLK_GPIO_NUM  10
#define SIOD_GPIO_NUM  40
#define SIOC_GPIO_NUM  39
#define Y9_GPIO_NUM    48
#define Y8_GPIO_NUM    11
#define Y7_GPIO_NUM    12
#define Y6_GPIO_NUM    14
#define Y5_GPIO_NUM    16
#define Y4_GPIO_NUM    18
#define Y3_GPIO_NUM    17
#define Y2_GPIO_NUM    15
#define VSYNC_GPIO_NUM 38
#define HREF_GPIO_NUM  47
#define PCLK_GPIO_NUM  13

// ================= MODLAR =================
enum AppMode { MAIN_MENU, SECURITY_MODE, AI_MODE, RESULT_VIEW, CLASSIC_MODE, SETTINGS_MODE, VOICE_MODE, TIMELAPSE_MODE, IT_MODE };
AppMode currentAppMode = MAIN_MENU;

// ================= CLASSIC MOD =================
enum ClassicState { CS_VIEWFINDER, CS_DONE };
ClassicState classicState  = CS_VIEWFINDER;
bool         classicLastOk = false;

// ================= SETTINGS =================
enum SettingId { SETT_PHOTO_TMR, SETT_GUARD_LOOP, SETT_BACK, SETT_COUNT };
const char* SETT_NAMES[] = { "PHOTO TIMER", "GUARD LOOP", "< BACK >" };

bool g_photoTimer = true;  // varsayilan: 3s geri sayim acik
bool g_guardLoop  = true;
int  g_settCursor = 0;

// ================= MENÜ =================
int menuCursor = 0;
const int MENU_ITEMS = 8;
const char* menuOptions[] = { "GUARD", "AI ASSIST", "CLASSIC", "VOICE", "TIMELAPSE", "SETTINGS", "IT SUPPORT", "SLEEP" };

String aiResult = "";

// ================= IT SUPPORT MOD =================
USBHIDKeyboard g_HIDKbd;          // USB HID klavye — setup()'ta başlatılır

// State machine: tap kacirilmasin diye blocking I/O minimumda tutulur
enum ItState {
  IT_S_NEED_REGISTER,   // VPS'e kaydolmasi gerekiyor (ilk giris veya hata sonrasi)
  IT_S_IDLE,            // Kaydoldu, periyodik poll yapiyor
  IT_S_TYPING_PENDING   // Komut alindi, bir sonraki loop'ta typing yapacak
};

char     g_itSessionId[12]          = "";  // VPS'ten alınan oturum ID'si
bool     g_itRegistered             = false;
ItState  g_itState                  = IT_S_NEED_REGISTER;
uint32_t g_itLastPollMs             = 0;
uint32_t g_itLastRegisterAttemptMs  = 0;
uint8_t  g_itRegisterRetryCount     = 0;
String   g_itPendingCmdType         = "";  // "collect" / "fix" / "test_keyboard"
String   g_itPendingBootstrap       = "";  // VPS'ten gelen hazir bootstrap satiri (Base64)

// ================= EKRAN KORUYUCU =================
uint32_t lastInteraction = 0;
bool     isScreenSaver   = false;

// ================= TAP KİLİT =================
bool     tapActive       = false;  // false = kilitli, 3 tap ile acilir
uint32_t lastTapActivity = 0;

// ================= TİMELAPSE GLOBALS =================
uint8_t** g_tlBufs        = NULL;  // PSRAM frame pointer dizisi
size_t*   g_tlSizes       = NULL;  // her frame'in byte boyutu
int       g_tlCount       = 0;     // PSRAM'daki mevcut frame sayisi
uint32_t  g_tlNextShot    = 0;     // bir sonraki frame vakti (millis)
uint32_t  g_tlOledUntil   = 0;     // bu vakitten sonra OLED kapanir (0=zaten kapali)
int       g_tlTotalFrames = 0;     // toplam gonderilen frame sayisi (tum batch'ler)
bool      g_tlLowPower    = false; // dusuk guc modu aktif mi (WiFi kes + CPU 80MHz)

// ================= WiFi ANİMASYON (32x32, PROGMEM) =================
// Kaynak: wokwi.com/animator — icons8.com
#define WIFI_ANIM_DELAY  42
#define WIFI_ANIM_W      32
#define WIFI_ANIM_H      32
#define WIFI_ANIM_COUNT  28

const uint8_t PROGMEM wifiFrames[WIFI_ANIM_COUNT][128] = {
  {0,0,0,0,0,0,0,0,0,0,0,0,0,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0,0},
  {0,0,0,0,0,0,0,0,0,0,0,0,0,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0,0},
  {0,0,0,0,0,0,0,0,0,0,0,0,0,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0,0},
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  {0,0,0,0,0,0,0,0,0,0,0,0,0,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0,0}
};

// ================= UPLOAD ANİMASYON (32x32, PROGMEM) =================
// Kaynak: wokwi.com/animator — icons8.com
#define UPLOAD_ANIM_DELAY  42
#define UPLOAD_ANIM_COUNT  28

const uint8_t PROGMEM uploadFrames[UPLOAD_ANIM_COUNT][128] = {
  {0,0,0,0,0,0,0,0,0,0,0,0,0,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0,0},
  {0,0,0,0,0,0,0,0,0,0,0,0,0,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0,0},
  {0,0,0,0,0,0,0,0,0,0,0,0,0,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0,0},
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  {0,0,0,0,0,0,0,0,0,0,0,0,0,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0,0}
};

// Upload animasyon frame sayaci (global, sendTlBatch ve diger gonderim fonksiyonlarinda kullanilir)
int      g_uploadAnimFrame = 0;
uint32_t g_uploadAnimLast  = 0;

// ================= MOD GEÇİŞ ANİMASYONU (64x64, sadece orta 32 satır kullanılır) =================
// Kaynak: wokwi.com/animator — icons8.com  |  Orijinal: 64x64px, 25 frame
// 128x32 OLED'de: x=32, y=0, 8 byte/satir, 32 satir (frame'in ortasi)
// (PROGMEM verisi yerinde kaliyor; aktif gecis artik slide-wipe kullanıyor)
#define TRANS_ANIM_DELAY   22   // (rezerv — artık kullanılmıyor)
#define TRANS_ANIM_COUNT   25
#define TRANS_ROW_OFFSET   128

// Slide-wipe gecis: 8 adim × 10ms = 80ms (non-blocking, super-hizli)
#define TRANS_SLIDE_STEPS   8    // toplam adim sayisi
#define TRANS_SLIDE_MS      10   // ms/adim

const uint8_t PROGMEM transFrames[TRANS_ANIM_COUNT][512] = {
  {0,0,0,0,0,0,0,0,0,0,0,0,0,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0,0},
  {0,0,0,0,0,0,0,0,0,0,0,0,0,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0,0},
  {0,0,0,0,0,0,0,0,0,0,0,0,0,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0,0},
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  {0,0,0,0,0,0,0,0,0,0,0,0,0,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0,0}
};

// ================= AI ANİMASYON (32x32, PROGMEM) =================
#define AI_ANIM_DELAY  42
#define AI_ANIM_COUNT  28

const uint8_t PROGMEM aiFrames[AI_ANIM_COUNT][128] = {
  {0,0,0,0,0,0,0,0,28,0,0,120,62,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0,0},
  {0,0,0,0,0,0,0,0,28,0,0,120,62,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0,0},
  {0,0,0,0,0,0,0,0,28,0,0,120,62,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0,0},
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  {0,0,0,0,0,0,0,0,28,0,0,120,62,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0,0}
};

// Geçiş animasyonu state
AppMode  g_transNext     = MAIN_MENU;
bool     g_transActive   = false;
int      g_transFrame    = 0;
uint32_t g_transLastMs   = 0;
// Slide-wipe: geçiş başlamadan önceki ekran içeriği (128×32 = 512 byte)
uint8_t  g_transSnapBuf[512];

// ================= PSRAM =================
bool      psramAvail    = false;
int       maxFrames     = MAX_FRAMES_RAM;
esp_err_t g_camInitError = ESP_OK;   // v3.31: kamera init hata kodu (OLED'e basmak icin)

// ================= GUARD =================
#define GUARD_BLOCKS_X        16
#define GUARD_BLOCKS_Y        12
#define GUARD_TOTAL_BLOCKS    (GUARD_BLOCKS_X * GUARD_BLOCKS_Y)
#define BLOCK_CHANGE_THRESHOLD 15
#define MOTION_BLOCK_PERCENT   5

static uint8_t prevBlockAvg[GUARD_TOTAL_BLOCKS];
static bool    hasPrevBlock = false;
static uint8_t* prevJpegBuf = NULL;
static size_t   prevJpegLen = 0;

// ================= AI PAGINATION =================
static String g_aiLines[12];
static int    g_aiLineCount = 0;
static int    g_aiPage      = 0;

// ================= PROTOTİPLER =================
void drawMainMenu();
void drawSecurityScreen();
void drawSettingsScreen();
void drawTextCenter(const char* text, int y);
void drawHeader();
void drawFooter();
void runSecurityMode();
void runAiMode();
bool uploadStreamToVPS(uint8_t** buffers, size_t* sizes, int count, int imgW, int imgH, int fps = 8);
bool initCamera();
void showStartupAnimation();
void goToSleep();
void reconnectWiFiIfNeeded();
void displayAiResult(const String& result);
void showStatusMsg(const char* line1, const char* line2 = "");
void guardInit();
void guardCleanup();
void drawClassicViewfinder();
void drawClassicDone();
bool sendPhotoToVPS(uint8_t* buf, size_t len);
void takeClassicPhoto();
void buildAiLines(const String& result);
void renderAiPage();
bool runCountdown(int seconds, const char* label);
String getSettingValue(int id);
void activateSetting();
void initMic();
int  checkTap();
void buildWavHeader(uint8_t* hdr, uint32_t dataBytes);
String sendVoiceToVPS(uint8_t* wavData, size_t wavSize);
void executeVoiceCommand(const String& cmd);
void captureAndSendVoiceCommand();
void drawVoiceScreen();
void drawUploadAnim();
void tlEnterLowPower();
void tlExitLowPower();
void startTimelapse();
void stopTimelapse(bool doFinalize);
void captureTimelapseFrame();
bool sendTlBatch();
bool sendTlFinalize();
void drawTimelapseScreen();
void runTimelapse();
void handleSingleTap();
void handleDoubleTap();
void startModeTransition(AppMode next);
bool tickModeTransition();
void initMode(AppMode mode);
void drawItScreen();
void runItMode();
bool itRegisterVPS();
String itPollVPS();
void itTypeBootstrapOnPc(const String& bootstrapCmd);
void itTypeStringHID(const String& str);
void itTypeAltCode(int ascii);
void itTypeKeyboardTest();
// (initOTA() v3.32'de kaldirildi)

// =========================================================
//  MİKROFON BAŞLAT
// =========================================================
void initMic() {
  micI2S.setPinsPdmRx(42, 41);
  micI2S.begin(I2S_MODE_PDM_RX, 16000, I2S_DATA_BIT_WIDTH_16BIT, I2S_SLOT_MODE_MONO);
  for (int i = 0; i < 5; i++) {
    micI2S.readBytes((char*)micBuf, sizeof(micBuf));
    delay(10);
  }
  Serial.println("Mikrofon hazir.");
}

// =========================================================
//  TAP ALGILAMA  (v3.7 — iki kritik hata duzeltildi)
//
//  Duzeltme 1 — prevPeak=0 hatasi:
//    Eskiden cooldown bittikten sonra prevPeak=0 yapiliyordu.
//    Ama cooldown blogu return 0 ile cikiyor yani peak hesaplanmadan once.
//    Sonraki cagride prevPeak=0 olunca ambient ses bile (1200+) tap gibi gorundugu oluyordu.
//    Duzeltme: peak'i her zaman once hesapla, cooldown cikisinda prevPeak=peak yap.
//
//  Duzeltme 2 — rezonans sorunu:
//    TAP_DEBOUNCE_MS=120ms: tek taptan sonra 130ms'de hala rezonans olabilir.
//    Bu rezonans delta>1100 yaparsa 2. tap sayiliyordu (2 fiziksel tap → 3 sayiliyor).
//    Duzeltme: TAP_DEBOUNCE_MS=200ms.
//
//  Donen deger: 0=yok, 1=tek tap, 2=cift tap, 3=uc tap  (4+ yoksayilir)
// =========================================================
int checkTap() {
  static uint8_t  tapState    = 0;  // 0=idle, 1=sayiyor, 2=cooldown
  static uint32_t lastTapTime = 0;
  static uint8_t  tapCount    = 0;
  static uint32_t cooldownEnd = 0;
  static int16_t  prevPeak    = 0;
  uint32_t now = millis();

  micI2S.readBytes((char*)micBuf, sizeof(micBuf));

  // ── Peak her zaman once hesaplanir ─────────────────────
  // (cooldown cikisinda prevPeak'i dogru baslangic degerine setlemek icin)
  int16_t peak = 0;
  for (int i = 0; i < 160; i++) {
    int16_t s = abs(micBuf[i]);
    if (s > peak) peak = s;
  }

  // ── Cooldown kontrolu ──────────────────────────────────
  if (tapState == 2) {
    if (now >= cooldownEnd) {
      tapState = 0;
      tapCount = 0;
      prevPeak = peak;  // DUZELTME: 0 degil, gercek seviyeye esitle
    }
    return 0;
  }

  // ── Delta hesapla ──────────────────────────────────────
  int16_t delta = peak - prevPeak;
  prevPeak = peak;
  bool tapped = (delta > TAP_DELTA_MIN);

  // ── Bosta: ilk tap bekleniyor ──────────────────────────
  if (tapState == 0) {
    if (tapped) { tapState = 1; tapCount = 1; lastTapTime = now; }
    return 0;
  }

  // ── Sayma: yeni tap var mi? ────────────────────────────
  if (tapped && (now - lastTapTime) > TAP_DEBOUNCE_MS) {
    tapCount++;
    lastTapTime = now;
    return 0;
  }

  // ── Emit: son taptan TAP_EMIT_DELAY gecti mi? ──────────
  if (now - lastTapTime >= TAP_EMIT_DELAY) {
    uint8_t count = tapCount;
    tapState    = 2;
    cooldownEnd = now + TAP_COOLDOWN_MS;
    tapCount    = 0;
    prevPeak    = peak;  // DUZELTME: 0 degil, gercek seviyeye esitle
    if (count >= 1 && count <= 3) return count;  // 1, 2 veya 3 tap: gecerli
    return 0;  // 4+ tap: yoksay
  }

  return 0;
}

// =========================================================
//  WAV HEADER (44 byte, little-endian)
//  mic_quality_test ile ayni format: 16kHz 16-bit mono PCM
// =========================================================
void buildWavHeader(uint8_t* hdr, uint32_t dataBytes) {
  uint32_t fileSize  = dataBytes + 36;
  uint32_t sr        = 16000;
  uint32_t byteRate  = 16000 * 2;
  uint16_t blockAl   = 2;
  uint16_t bitsPS    = 16;
  uint16_t numCh     = 1;
  uint16_t audioFmt  = 1;   // PCM
  uint32_t fmtChunk  = 16;
  memcpy(hdr +  0, "RIFF",    4);  memcpy(hdr +  4, &fileSize, 4);
  memcpy(hdr +  8, "WAVE",    4);  memcpy(hdr + 12, "fmt ",    4);
  memcpy(hdr + 16, &fmtChunk, 4);  memcpy(hdr + 20, &audioFmt, 2);
  memcpy(hdr + 22, &numCh,    2);  memcpy(hdr + 24, &sr,       4);
  memcpy(hdr + 28, &byteRate, 4);  memcpy(hdr + 32, &blockAl,  2);
  memcpy(hdr + 34, &bitsPS,   2);  memcpy(hdr + 36, "data",    4);
  memcpy(hdr + 40, &dataBytes,4);
}

// =========================================================
//  SES KOMUTU VPS'E GONDER → Komut adini don
//  VPS /voice_command → Gemini → "guard"/"ai"/"photo"/...
// =========================================================
String sendVoiceToVPS(uint8_t* wavData, size_t wavSize) {
  if (WiFi.status() != WL_CONNECTED) {
    Serial.println("sendVoiceToVPS: WiFi yok");
    return "";
  }

  WiFiClient client;
  bool connected = false;
  for (int attempt = 1; attempt <= 3 && !connected; attempt++) {
    connected = client.connect(vps_host.c_str(), vps_port);
    if (!connected) { Serial.printf("  Baglanti %d/3 basarisiz\n", attempt); delay(600); }
  }
  if (!connected) { Serial.println("sendVoiceToVPS: VPS baglantisi kurulamadi!"); return ""; }

  const String boundary = "VOICECMD123";
  String head =
    "--" + boundary + "\r\n"
    "Content-Disposition: form-data; name=\"audio\"; filename=\"voice_cmd.wav\"\r\n"
    "Content-Type: audio/wav\r\n\r\n";
  String tail = "\r\n--" + boundary + "--\r\n";
  long totalLen = head.length() + (long)wavSize + tail.length();

  client.println("POST /voice_command HTTP/1.1");
  client.println("Host: " + vps_host);
  client.println("Content-Type: multipart/form-data; boundary=" + boundary);
  client.print("Content-Length: "); client.println(totalLen);
  client.println("Connection: close");
  client.println();
  client.print(head);

  size_t sent = 0;
  while (sent < wavSize) {
    size_t chunk   = min((size_t)4096, wavSize - sent);
    size_t written = client.write(wavData + sent, chunk);
    if (written > 0) sent += written; else delay(10);
    yield();
  }
  client.print(tail);

  String responseBody = "";
  bool   isBody       = false;
  long   start        = millis();
  while ((client.connected() || client.available()) && millis() - start < 30000) {
    if (client.available()) {
      String line = client.readStringUntil('\n');
      line.trim();
      if (isBody) responseBody += line;
      else if (line == "") isBody = true;
    }
    yield();
  }
  client.stop();

  Serial.printf("VPS yaniti: %s\n", responseBody.c_str());
  DynamicJsonDocument doc(256);
  if (!deserializeJson(doc, responseBody) && doc.containsKey("command")) {
    return doc["command"].as<String>();
  }
  return "";
}

// =========================================================
//  SES KOMUTU UYGULA
//  VPS'ten gelen komut adina gore ilgili modu/aksiyonu baslat
// =========================================================
void executeVoiceCommand(const String& cmd) {
  Serial.printf("executeVoiceCommand: '%s'\n", cmd.c_str());

  if (cmd == "guard") {
    hasPrevBlock   = false;
    currentAppMode = SECURITY_MODE;
    for (int cd = 3; cd > 0; cd--) {
      char buf[24]; snprintf(buf, sizeof(buf), "Guard: %d...", cd);
      showStatusMsg(buf, "3x:Dur");
      delay(1000);
    }
    showStatusMsg("GUARD AKTIF", "");
    delay(500);
    drawSecurityScreen();
  }
  else if (cmd == "ai") {
    currentAppMode = AI_MODE;
    runAiMode();
  }
  else if (cmd == "photo") {
    classicState   = CS_VIEWFINDER;
    currentAppMode = CLASSIC_MODE;
    sensor_t* sc   = esp_camera_sensor_get();
    if (sc) sc->set_framesize(sc, psramAvail ? FRAMESIZE_VGA : FRAMESIZE_QVGA);
    delay(150);
    takeClassicPhoto();
  }
  else if (cmd == "settings") {
    g_settCursor   = 0;
    currentAppMode = SETTINGS_MODE;
    drawSettingsScreen();
  }
  else if (cmd == "sleep") {
    goToSleep();
  }
  else if (cmd == "back") {
    currentAppMode = MAIN_MENU;
    drawMainMenu();
  }
  else if (cmd == "next") {
    if (currentAppMode == MAIN_MENU) {
      menuCursor = (menuCursor + 1) % MENU_ITEMS;
      drawMainMenu();
    }
  }
  else {  // unknown veya bos
    showStatusMsg("Anlasılamadı", "Tekrar deneyin");
    delay(1500);
    switch (currentAppMode) {
      case MAIN_MENU:     drawMainMenu();          break;
      case CLASSIC_MODE:  drawClassicViewfinder(); break;
      case SETTINGS_MODE: drawSettingsScreen();    break;
      case SECURITY_MODE: drawSecurityScreen();    break;
      case VOICE_MODE:    drawVoiceScreen();       break;
      default:            drawMainMenu();          break;
    }
  }
}

// =========================================================
//  SES KAYDI + GONDERME AKISI
//  1. I2S sifirla (temiz baslangic)
//  2. 2 saniye ses kaydet → PSRAM
//  3. VPS /voice_command → Gemini → komut adi
//  4. executeVoiceCommand() ile calistir
// =========================================================
void captureAndSendVoiceCommand() {
  Serial.println("Ses komutu yakalanıyor...");

  if (!psramAvail) {
    showStatusMsg("HATA", "PSRAM Gerekli!");
    delay(1500);
    drawMainMenu();
    return;
  }

  uint8_t* wavBuf = (uint8_t*)ps_malloc(VOICE_WAV_TOTAL);
  if (!wavBuf) {
    showStatusMsg("HATA", "Bellek Yok!");
    delay(1500);
    drawMainMenu();
    return;
  }

  buildWavHeader(wavBuf, VOICE_BYTES);
  memset(wavBuf + 44, 0, VOICE_BYTES);

  // I2S temiz baslangic: DMA buffer eski veri icermeyecek
  micI2S.end();
  delay(100);
  micI2S.setPinsPdmRx(42, 41);
  micI2S.begin(I2S_MODE_PDM_RX, 16000, I2S_DATA_BIT_WIDTH_16BIT, I2S_SLOT_MODE_MONO);
  delay(200);  // Kısa bekleme: komut anında söyleniyor

  // Kayit
  int16_t* pcm      = (int16_t*)(wavBuf + 44);
  int      recorded = 0;
  int16_t  rdBuf[160];

  // Ilk ekran: kayit basliyor
  u8g2.clearBuffer();
  u8g2.setFont(u8g2_font_5x7_tr);
  drawTextCenter("MIC AKTIF", 8);
  drawTextCenter("Komut soyleyin", 17);
  u8g2.drawFrame(4, 23, 120, 7);
  u8g2.setFont(u8g2_font_6x10_tr);
  u8g2.sendBuffer();

  uint32_t recStart = millis();

  while (recorded < VOICE_SAMPLES) {
    int got = micI2S.readBytes((char*)rdBuf, sizeof(rdBuf));
    if (got <= 0) { delay(2); continue; }
    int toCopy = min(160, VOICE_SAMPLES - recorded);
    memcpy(pcm + recorded, rdBuf, toCopy * 2);
    recorded += toCopy;

    // Her %12.5'te ekrani guncelle (8 adim)
    if (recorded % 4000 == 0) {
      int barW = (120 * recorded) / VOICE_SAMPLES;
      int pct  = (recorded * 100) / VOICE_SAMPLES;
      u8g2.clearBuffer();
      u8g2.setFont(u8g2_font_5x7_tr);
      drawTextCenter("MIC AKTIF", 8);
      drawTextCenter("Komut soyleyin", 17);
      u8g2.drawFrame(4, 23, 120, 7);
      if (barW > 0) u8g2.drawBox(4, 23, barW, 7);
      char buf[8]; snprintf(buf, sizeof(buf), "%d%%", pct);
      drawTextCenter(buf, 31);
      u8g2.setFont(u8g2_font_6x10_tr);
      u8g2.sendBuffer();
    }
    yield();
  }
  Serial.printf("Ses kaydi tamamlandi (%d ms, %d byte)\n",
                millis() - recStart, VOICE_BYTES);

  showStatusMsg("Anlasiliyor...", "Bekleyin...");

  // I2S tap moduna geri al
  micI2S.end();
  delay(50);
  micI2S.setPinsPdmRx(42, 41);
  micI2S.begin(I2S_MODE_PDM_RX, 16000, I2S_DATA_BIT_WIDTH_16BIT, I2S_SLOT_MODE_MONO);
  for (int i = 0; i < 5; i++) { micI2S.readBytes((char*)micBuf, sizeof(micBuf)); delay(10); }

  // VPS'e gonder
  String command = sendVoiceToVPS(wavBuf, VOICE_WAV_TOTAL);
  free(wavBuf);

  Serial.printf("VPS komutu alindi: '%s'\n", command.c_str());

  if (command.length() == 0) {
    showStatusMsg("Ag Hatasi", "WiFi/VPS hata");
    delay(1800);
    switch (currentAppMode) {
      case MAIN_MENU:     drawMainMenu();          break;
      case CLASSIC_MODE:  drawClassicViewfinder(); break;
      case SETTINGS_MODE: drawSettingsScreen();    break;
      case VOICE_MODE:    drawVoiceScreen();       break;
      default:            drawMainMenu();          break;
    }
    return;
  }

  // Komutu ekranda goster
  char dispBuf[20];
  snprintf(dispBuf, sizeof(dispBuf), ">>> %s", command.c_str());
  showStatusMsg(dispBuf, "Calisiyor...");
  delay(700);

  executeVoiceCommand(command);
}

// =========================================================
//  SETUP
// =========================================================
void setup() {
  // Brownout dedektörünü devre disi birak.
  // WRITE_PERI_REG(RTC_CNTL_BROWN_OUT_REG, 0) tüm register'i sifirlar
  // → ESP32-S3+IDF v5'te bootloop. Sadece ENA bitini temizle (güvenli):
  REG_CLR_BIT(RTC_CNTL_BROWN_OUT_REG, RTC_CNTL_BROWN_OUT_ENA);

  Serial.begin(115200);
  delay(800);
  Serial.println("\n--- SMART OS v3.32 STARTING ---");

  Wire.begin(5, 6);
  u8g2.begin();
  u8g2.setFont(u8g2_font_6x10_tr);

  pinMode(BUTTON_PIN, INPUT_PULLUP);

  psramAvail = psramFound();
  maxFrames  = psramAvail ? MAX_FRAMES_PSRAM : MAX_FRAMES_RAM;
  Serial.printf("PSRAM: %s | Maks kare: %d\n", psramAvail ? "VAR" : "YOK", maxFrames);

  showStartupAnimation();

  WiFi.mode(WIFI_STA);
  WiFi.setSleep(false);
  WiFi.setAutoReconnect(true);
  WiFi.begin(ssid, password);
  Serial.print("WiFi baglaniliyor");

  // WiFi bağlanırken animasyon oynat
  // 32x32 ikon → 128x32 ekranda yatayda ortala (x=48), dikeyde tam doldur (y=0)
  {
    int wifiFrame = 0;
    uint32_t wStart = millis();
    uint32_t lastFrameTime = 0;
    while (WiFi.status() != WL_CONNECTED && millis() - wStart < 15000) {
      uint32_t now = millis();
      if (now - lastFrameTime >= WIFI_ANIM_DELAY) {
        lastFrameTime = now;
        u8g2.clearBuffer();
        u8g2.drawBitmap(48, 0, 4, 32, wifiFrames[wifiFrame]);
        u8g2.sendBuffer();
        wifiFrame = (wifiFrame + 1) % WIFI_ANIM_COUNT;
        Serial.print(".");
      }
      yield();
    }
  }

  if (WiFi.status() == WL_CONNECTED) {
    Serial.printf("\nWiFi OK: %s\n", WiFi.localIP().toString().c_str());
    showStatusMsg("WiFi OK!", WiFi.localIP().toString().c_str());
    delay(800);
  } else {
    Serial.println("\nWiFi BASARISIZ - Offline mod.");
    showStatusMsg("WiFi FAILED", "Offline mode");
    delay(1500);
  }

  if (!initCamera()) {
    // v3.31: Detayli tani ekrani — Serial Monitor olmadan da gorulebilir
    // 3 satir: CAM FAIL  /  ERR 0x???  /  PSRAM: VAR or YOK
    u8g2.clearBuffer();
    u8g2.setFont(u8g2_font_6x10_tr);
    drawTextCenter("CAM INIT FAIL", 9);

    char errBuf[24];
    snprintf(errBuf, sizeof(errBuf), "ERR 0x%X",
             (unsigned)g_camInitError);
    drawTextCenter(errBuf, 19);

    char psramBuf[24];
    snprintf(psramBuf, sizeof(psramBuf), "PSRAM:%s",
             psramAvail ? "VAR" : "YOK");
    u8g2.setFont(u8g2_font_5x7_tr);
    drawTextCenter(psramBuf, 30);
    u8g2.setFont(u8g2_font_6x10_tr);
    u8g2.sendBuffer();

    delay(8000);   // Kullaniciya okuma suresi ver
  }

  initMic();

  // USB HID Klavye — IT Support modu için
  // Serial (UART0) bu başlatma ile çakışmaz
  g_HIDKbd.begin();
  USB.begin();

  lastInteraction = millis();
  drawMainMenu();
}

// =========================================================
//  MOD GEÇİŞ ANİMASYONU (non-blocking)
// =========================================================

// Geçişi başlatır — çağırınca loop() animasyonu kendi yürütür
void startModeTransition(AppMode next) {
  g_transNext   = next;
  g_transActive = true;
  g_transFrame  = 0;
  g_transLastMs = 0;
  u8g2.setPowerSave(0);
  // Mevcut ekran içeriğini snapshot al (slide-wipe için kaynak)
  uint8_t* live = u8g2.getBufferPtr();
  if (live) memcpy(g_transSnapBuf, live, 512);
  else      memset(g_transSnapBuf, 0, 512);
}

// Slide-wipe geçiş animasyonu — her loop() çağrısında 1 adım işler
// 8 adım × 10ms = 80ms toplam | non-blocking | sıfır delay
// Mekanizma: snapshot buffer'ı sola kaydırarak ekrandan uçurur
// Geri dönüş: true = animasyon bitti → initMode() çağır
bool tickModeTransition() {
  uint32_t now = millis();
  if (now - g_transLastMs < TRANS_SLIDE_MS) return false;
  g_transLastMs = now;

  // 128px ekranı 8 adımda tamamen sola kaydır (adım başı 16px)
  // g_transFrame: 0→7 (adım 1→8), her adımda toplam offset = (frame+1)*16
  int shift = (g_transFrame + 1) * 16;  // 16, 32, 48, 64, 80, 96, 112, 128

  uint8_t* dst = u8g2.getBufferPtr();
  if (dst) {
    // 128×32 OLED = 4 sayfa × 128 sütun (her byte = 8 dikey piksel)
    for (int page = 0; page < 4; page++) {
      uint8_t* srcRow = g_transSnapBuf + page * 128;
      uint8_t* dstRow = dst            + page * 128;
      int remain = 128 - shift;
      if (remain > 0) memcpy(dstRow, srcRow + shift, remain);
      if (shift  > 0) memset(dstRow + (remain > 0 ? remain : 0), 0,
                             (shift < 128 ? shift : 128));
    }
    u8g2.sendBuffer();
  }

  if (++g_transFrame >= TRANS_SLIDE_STEPS) {
    g_transActive = false;
    return true;   // animasyon tamamlandı → initMode() çağrılacak
  }
  return false;
}

// Animasyon bittikten sonra hedef modu başlatır
void initMode(AppMode mode) {
  currentAppMode = mode;
  switch (mode) {

    case MAIN_MENU:
      drawMainMenu();
      break;

    case SECURITY_MODE: {
      hasPrevBlock = false;
      for (int cd = 5; cd > 0; cd--) {
        char cdBuf[20];
        snprintf(cdBuf, sizeof(cdBuf), "Starting in %d...", cd);
        showStatusMsg("GUARD MODE", cdBuf);
        delay(1000);
      }
      showStatusMsg("GUARD MODE", "ACTIVE!");
      delay(500);
      drawSecurityScreen();
      break;
    }

    case AI_MODE:
      runAiMode();
      break;

    case CLASSIC_MODE: {
      classicState = CS_VIEWFINDER;
      sensor_t* sc = esp_camera_sensor_get();
      if (sc) sc->set_framesize(sc, psramAvail ? FRAMESIZE_VGA : FRAMESIZE_QVGA);
      delay(150);
      drawClassicViewfinder();
      break;
    }

    case VOICE_MODE:
      drawVoiceScreen();
      break;

    case TIMELAPSE_MODE:
      startTimelapse();
      break;

    case SETTINGS_MODE:
      g_settCursor = 0;
      drawSettingsScreen();
      break;

    case IT_MODE:
      // State machine'i sifirla - runItMode() bir sonraki loop'ta register dener
      g_itRegistered            = false;
      g_itState                 = IT_S_NEED_REGISTER;
      g_itLastRegisterAttemptMs = 0;
      g_itLastPollMs            = 0;
      g_itRegisterRetryCount    = 0;
      g_itPendingCmdType        = "";
      drawItScreen();
      // NOT: itRegisterVPS() artik blocking sekilde burada cagrilmiyor.
      // runItMode() ilk loop iterasyonunda register denemesi yapacak.
      // Bu sayede 3x tap cikis garantili — registration sirasinda bile tap yakalanir.
      break;

    default:
      currentAppMode = MAIN_MENU;
      drawMainMenu();
      break;
  }
}

// =========================================================
//  ANA DONGU
// =========================================================
void loop() {
  uint32_t now = millis();

  // Mod geçiş animasyonu — en yüksek öncelik, non-blocking (22ms/kare)
  if (g_transActive) {
    checkTap();  // tap'ları absorbe et, işleme
    if (tickModeTransition()) initMode(g_transNext);
    return;
  }

  if (currentAppMode == MAIN_MENU) reconnectWiFiIfNeeded();

  // Ekran koruyucu
  if (currentAppMode == MAIN_MENU && !isScreenSaver && (now - lastInteraction > SCREEN_SAVER_MS)) {
    u8g2.setPowerSave(1);
    isScreenSaver = true;
  }

  // Otomatik kilit: 40sn tap olmazsa kilitle
  if (tapActive && now - lastTapActivity > TAP_LOCK_MS) {
    tapActive = false;
    Serial.println("Tap: Otomatik kilit aktif.");
  }

  int tapCount = checkTap();

  if (tapCount > 0) {
    if (!tapActive) {
      // KİLİTLİ: sadece 3 tap kilit acar
      if (tapCount == 3) {
        tapActive       = true;
        lastTapActivity = now;
        lastInteraction = now;
        if (isScreenSaver) {
          isScreenSaver = false;
          u8g2.setPowerSave(0);
        }
        showStatusMsg("TAP AKTIF", "3x ile kilit");
        delay(600);
        drawMainMenu();
      }
      // 1 veya 2 tap kilitliyken: tamamen yoksay
      return;
    }

    // AÇIK: normal komutlar
    lastTapActivity = now;
    lastInteraction = now;

    if (isScreenSaver) {
      isScreenSaver = false;
      u8g2.setPowerSave(0);
      drawMainMenu();
      return;
    }

    // Guard ve Timelapse modda sadece 3x tap geçerli → durdur/çık
    if (currentAppMode == SECURITY_MODE) {
      if (tapCount == 3) {
        guardCleanup();
        sensor_t* sg = esp_camera_sensor_get();
        if (sg) sg->set_framesize(sg, psramAvail ? FRAMESIZE_VGA : FRAMESIZE_QVGA);
        startModeTransition(MAIN_MENU);
      }
      // 1x veya 2x tap guard modda tamamen yoksayılır
      return;
    }
    if (currentAppMode == TIMELAPSE_MODE) {
      if (tapCount == 3) {
        stopTimelapse(true);   // kalan frameleri gönder + video + Telegram + çık
      }
      // 1x veya 2x tap timelapse modda tamamen yoksayılır
      return;
    }
    if (currentAppMode == IT_MODE) {
      if (tapCount == 3) {
        g_itRegistered = false;
        startModeTransition(MAIN_MENU);
      }
      // 1x veya 2x tap IT modda yoksayılır (yanlışlıkla script tetiklenmesin)
      return;
    }

    if      (tapCount == 1) handleSingleTap();   // 1 tap = navigate/aksiyon
    else if (tapCount == 2) handleDoubleTap();   // 2 tap = gir/onayla
    return;
  }

  // Tap flash goselini 200ms sonra temizle
  if (g_tapFlash > 0 && now - g_tapFlash >= 200 && now - g_tapFlash < 300) {
    g_tapFlash = 0;
    switch (currentAppMode) {
      case MAIN_MENU:     if (!isScreenSaver) drawMainMenu(); break;
      case CLASSIC_MODE:
        if (classicState == CS_VIEWFINDER) drawClassicViewfinder();
        else                               drawClassicDone();
        break;
      case SETTINGS_MODE: drawSettingsScreen(); break;
      case SECURITY_MODE: drawSecurityScreen(); break;
      case RESULT_VIEW:   renderAiPage();       break;
      case VOICE_MODE:    drawVoiceScreen();    break;
      case TIMELAPSE_MODE:
        if (g_tlOledUntil > 0) drawTimelapseScreen();
        break;
      default: break;
    }
  }

  if (currentAppMode == SECURITY_MODE)  runSecurityMode();
  if (currentAppMode == TIMELAPSE_MODE) runTimelapse();
  if (currentAppMode == IT_MODE)        runItMode();
}

// =========================================================
//  TEK TAP AKSIYONU
// =========================================================
void handleSingleTap() {
  g_tapFlash      = millis();
  lastInteraction = millis();

  switch (currentAppMode) {
    case MAIN_MENU:
      menuCursor = (menuCursor + 1) % MENU_ITEMS;
      drawMainMenu();
      break;

    case RESULT_VIEW: {
      int totalPages = max(1, (g_aiLineCount + 3) / 4);
      if (g_aiPage < totalPages - 1) {
        g_aiPage++;
        renderAiPage();
      } else {
        startModeTransition(MAIN_MENU);
      }
      break;
    }

    case CLASSIC_MODE:
      if (classicState == CS_VIEWFINDER) takeClassicPhoto();
      else { classicState = CS_VIEWFINDER; drawClassicViewfinder(); }
      break;

    case SETTINGS_MODE:
      g_settCursor = (g_settCursor + 1) % SETT_COUNT;
      drawSettingsScreen();
      break;

    case SECURITY_MODE:
      // 1x tap guard modda yoksayılır — sadece 3x tap durdurur (loop() içinde işlenir)
      break;

    case VOICE_MODE:
      // 1x tap → dinlemeye basla
      captureAndSendVoiceCommand();
      if (currentAppMode == VOICE_MODE) drawVoiceScreen();
      break;

    case TIMELAPSE_MODE:
      // 1x tap timelapse modda yoksayılır — sadece 3x tap durdurur (loop() içinde işlenir)
      break;

    default:
      break;
  }
}

// =========================================================
//  CIFT TAP AKSIYONU
// =========================================================
void handleDoubleTap() {
  g_tapFlash      = millis();
  lastInteraction = millis();

  switch (currentAppMode) {

    case MAIN_MENU:
      switch (menuCursor) {
        case 0: // GUARD
          startModeTransition(SECURITY_MODE);
          break;
        case 1: // AI ASSIST
          startModeTransition(AI_MODE);
          break;
        case 2: // CLASSIC
          startModeTransition(CLASSIC_MODE);
          break;
        case 3: // VOICE MODE
          startModeTransition(VOICE_MODE);
          break;
        case 4: // TIMELAPSE
          startModeTransition(TIMELAPSE_MODE);
          break;
        case 5: // SETTINGS
          startModeTransition(SETTINGS_MODE);
          break;
        case 6: // IT SUPPORT
          startModeTransition(IT_MODE);
          break;
        case 7: // SLEEP
          goToSleep();
          break;
        default:
          showStatusMsg("NOT READY", "Coming soon...");
          delay(1500);
          drawMainMenu();
          break;
      }
      break;

    case SECURITY_MODE:
      // 2x tap guard modda yoksayılır — sadece 3x tap durdurur (loop() içinde işlenir)
      break;

    case RESULT_VIEW:
      startModeTransition(MAIN_MENU);
      break;

    case CLASSIC_MODE: {
      sensor_t* s2 = esp_camera_sensor_get();
      if (s2) s2->set_framesize(s2, psramAvail ? FRAMESIZE_VGA : FRAMESIZE_QVGA);
      startModeTransition(MAIN_MENU);
      break;
    }

    case SETTINGS_MODE:
      activateSetting();
      break;

    case VOICE_MODE:
      // 2x tap → ana menuye don
      startModeTransition(MAIN_MENU);
      break;

    case TIMELAPSE_MODE:
      // 2x tap timelapse modda yoksayılır — sadece 3x tap durdurur (loop() içinde işlenir)
      break;

    default:
      break;
  }
}

// =========================================================
//  SETTINGS
// =========================================================

String getSettingValue(int id) {
  switch (id) {
    case SETT_PHOTO_TMR:  return g_photoTimer ? "3 sec" : "OFF";
    case SETT_GUARD_LOOP: return g_guardLoop  ? "LOOP" : "ONE-SHOT";
    case SETT_BACK:       return "-> Main";
  }
  return "";
}

void activateSetting() {
  switch (g_settCursor) {
    case SETT_PHOTO_TMR:
      g_photoTimer = !g_photoTimer;
      drawSettingsScreen();
      break;
    case SETT_GUARD_LOOP:
      g_guardLoop = !g_guardLoop;
      drawSettingsScreen();
      break;
    case SETT_BACK:
      g_settCursor   = 0;
      currentAppMode = MAIN_MENU;
      drawMainMenu();
      break;
  }
}

void drawSettingsScreen() {
  u8g2.clearBuffer();
  drawHeader();
  u8g2.setFont(u8g2_font_6x10_tr);
  drawTextCenter(SETT_NAMES[g_settCursor], 11);

  String val = getSettingValue(g_settCursor);
  drawTextCenter(val.c_str(), 22);

  u8g2.setFont(u8g2_font_4x6_tr);
  if (g_settCursor == SETT_BACK) drawTextCenter("1x:Skip  2x:Back", 31);
  else                           drawTextCenter("1x:Next  2x:Toggle", 31);
  u8g2.setFont(u8g2_font_6x10_tr);
  u8g2.sendBuffer();
}

// Geri sayim; true=devam, false=cift-tap ile iptal
bool runCountdown(int seconds, const char* label) {
  // Aktivasyon tapinin bitmesini bekle (kisa gecikme)
  for (int i = 0; i < 3; i++) {
    micI2S.readBytes((char*)micBuf, sizeof(micBuf));
    delay(10);
  }

  for (int i = seconds; i > 0; i--) {
    char buf[24];
    snprintf(buf, sizeof(buf), "%s in %d...", label, i);
    showStatusMsg(buf, "2x:Cancel");
    uint32_t t = millis();
    while (millis() - t < 1000) {
      int tap = checkTap();
      if (tap == 2) return false;  // cift tap = iptal
      yield();
      delay(20);
    }
  }
  return true;
}

// =========================================================
//  GUARD / GÜVENLİK MODU
// =========================================================

void guardInit() {
  sensor_t* s = esp_camera_sensor_get();
  if (!s) return;
  s->set_framesize(s, FRAMESIZE_QQVGA);
  delay(100);

  const int CAL_FRAMES   = 20;
  const int CAL_DELAY_MS = 150;

  for (int i = 0; i < CAL_FRAMES; i++) {
    camera_fb_t* f = esp_camera_fb_get();
    if (f) esp_camera_fb_return(f);

    if (i % 5 == 0) {
      int pct  = (i * 100) / CAL_FRAMES;
      int barW = (128 * pct) / 100;
      u8g2.clearBuffer();
      u8g2.setFont(u8g2_font_6x10_tr);
      drawTextCenter("Light Calib", 10);
      u8g2.drawFrame(0, 18, 128, 10);
      if (barW > 0) u8g2.drawBox(0, 18, barW, 10);
      char pctBuf[8];
      snprintf(pctBuf, sizeof(pctBuf), "%d%%", pct);
      drawTextCenter(pctBuf, 31);
      u8g2.sendBuffer();
    }
    delay(CAL_DELAY_MS);
    yield();
  }

  if (prevJpegBuf) { free(prevJpegBuf); prevJpegBuf = NULL; }
  prevJpegLen = 0;

  showStatusMsg("Guard Ready", "Watching...");
  delay(400);
  Serial.println("Guard: Isik kalibrasyonu tamamlandi.");
}

void guardCleanup() {
  if (prevJpegBuf) { free(prevJpegBuf); prevJpegBuf = NULL; }
  prevJpegLen = 0;
}

void runSecurityMode() {
  static uint32_t lastFrameTime = 0;
  static bool     guardReady    = false;
  static int      warmupFrames  = 0;
  uint32_t now = millis();

  if (now - lastFrameTime < GUARD_FRAME_DELAY) return;
  lastFrameTime = now;

  if (!guardReady) {
    guardInit();
    guardReady   = true;
    warmupFrames = 0;
    return;
  }

  camera_fb_t* fb = esp_camera_fb_get();
  if (!fb) { Serial.println("Guard: Frame alinamadi!"); return; }

  if (warmupFrames < 5) {
    warmupFrames++;
    if (warmupFrames == 5) {
      if (prevJpegBuf) free(prevJpegBuf);
      prevJpegBuf = (uint8_t*)(psramAvail ? ps_malloc(fb->len) : malloc(fb->len));
      if (prevJpegBuf) { memcpy(prevJpegBuf, fb->buf, fb->len); prevJpegLen = fb->len; }
    }
    esp_camera_fb_return(fb);
    return;
  }

  if (!prevJpegBuf || prevJpegLen == 0) {
    prevJpegBuf = (uint8_t*)(psramAvail ? ps_malloc(fb->len) : malloc(fb->len));
    if (prevJpegBuf) { memcpy(prevJpegBuf, fb->buf, fb->len); prevJpegLen = fb->len; }
    esp_camera_fb_return(fb);
    return;
  }

  size_t cmpLen = min(prevJpegLen, fb->len);
  int diffCount = 0, totalCompared = 0;
  for (size_t i = 0; i < cmpLen; i += 4) {
    if (abs((int)fb->buf[i] - (int)prevJpegBuf[i]) > 25) diffCount++;
    totalCompared++;
  }
  int sizeDiff = abs((int)fb->len - (int)prevJpegLen);
  float sizeChangePct = (prevJpegLen > 0) ? (sizeDiff * 100.0f / prevJpegLen) : 0;
  float byteChangePct = (totalCompared > 0) ? (diffCount * 100.0f / totalCompared) : 0;

  static int frameNum = 0;
  frameNum++;
  if (frameNum % 3 == 0)
    Serial.printf("Guard #%d: Byte=%.1f%% Size=%.1f%%\n", frameNum, byteChangePct, sizeChangePct);

  if (fb->len != prevJpegLen) {
    free(prevJpegBuf);
    prevJpegBuf = (uint8_t*)(psramAvail ? ps_malloc(fb->len) : malloc(fb->len));
  }
  if (prevJpegBuf) { memcpy(prevJpegBuf, fb->buf, fb->len); prevJpegLen = fb->len; }
  esp_camera_fb_return(fb);

  bool frameHasMotion = (byteChangePct > 40.0f) || (sizeChangePct > 50.0f);
  static int consecutiveMotion = 0;
  if (frameHasMotion) consecutiveMotion++;
  else                consecutiveMotion = 0;
  if (consecutiveMotion < 3) return;
  consecutiveMotion = 0;

  // ===== HAREKET ALGILANDI =====
  Serial.printf("HAREKET! Byte=%.1f%% Size=%.1f%%\n", byteChangePct, sizeChangePct);

  // 3 tap ile iptal edilebilir bekleme yardimcisi
  // true donerse iptal, false donerse normal tamamlandi
  auto tapDelay = [](uint32_t ms) -> bool {
    uint32_t t = millis();
    while (millis() - t < ms) {
      if (checkTap() == 2) return true;
      delay(10);
    }
    return false;
  };

  showStatusMsg("!! MOTION !!", "2x:Cancel");
  if (tapDelay(400)) {
    // Iptal: guard modundan ana menuye don
    guardReady = false; warmupFrames = 0;
    currentAppMode = MAIN_MENU; drawMainMenu();
    return;
  }

  guardCleanup();
  u8g2.setPowerSave(1);

  sensor_t* s = esp_camera_sensor_get();
  if (s) s->set_framesize(s, FRAMESIZE_VGA);
  if (tapDelay(400)) {
    u8g2.setPowerSave(0);
    if (s) s->set_framesize(s, FRAMESIZE_QQVGA);
    guardReady = false; warmupFrames = 0;
    currentAppMode = MAIN_MENU; drawMainMenu();
    return;
  }

  // Ilk kareyi at (sensor stabilizasyonu)
  camera_fb_t* warmFb = esp_camera_fb_get();
  if (warmFb) { esp_camera_fb_return(warmFb); delay(80); }

  uint8_t** bufs  = (uint8_t**)malloc(maxFrames * sizeof(uint8_t*));
  size_t*   sizes = (size_t*)  malloc(maxFrames * sizeof(size_t));
  int   count       = 0;
  bool  capCancelled = false;

  if (bufs && sizes) {
    for (int i = 0; i < maxFrames; i++) {
      if (checkTap() == 2) { capCancelled = true; break; }
      fb = esp_camera_fb_get();
      if (fb) {
        uint8_t* mem = psramAvail ? (uint8_t*)ps_malloc(fb->len) : (uint8_t*)malloc(fb->len);
        if (mem) { memcpy(mem, fb->buf, fb->len); bufs[count] = mem; sizes[count] = fb->len; count++; }
        esp_camera_fb_return(fb);
      }
      yield(); delay(50);
    }
  }

  if (capCancelled || !bufs || !sizes) {
    // Iptal veya bellek hatasi
    u8g2.setPowerSave(0);
    if (bufs) { for (int i = 0; i < count; i++) if (bufs[i]) free(bufs[i]); free(bufs); }
    if (sizes) free(sizes);
    if (s) s->set_framesize(s, FRAMESIZE_QQVGA);
    guardReady = false; warmupFrames = 0;
    currentAppMode = MAIN_MENU; drawMainMenu();
    return;
  }

  u8g2.setPowerSave(0);
  showStatusMsg("Uploading...", "Please wait...");
  bool uploaded = uploadStreamToVPS(bufs, sizes, count, 640, 480);
  for (int i = 0; i < count; i++) if (bufs[i]) free(bufs[i]);
  free(bufs); free(sizes);

  if (uploaded) showStatusMsg("Alert Sent!", g_guardLoop ? "Watching..." : "Done.");
  else          showStatusMsg("Upload FAIL", "WiFi/VPS err");

  delay(2000);

  if (s) s->set_framesize(s, FRAMESIZE_QQVGA);

  if (g_guardLoop) {
    guardReady   = false;
    warmupFrames = 0;
    drawSecurityScreen();
    Serial.println("Guard: Izlemeye devam ediliyor...");
  } else {
    guardReady     = false;
    warmupFrames   = 0;
    currentAppMode = MAIN_MENU;
    drawMainMenu();
    Serial.println("Guard: One-shot - ana menuye donuldu.");
  }
}

// =========================================================
//  TİMELAPSE — PSRAM doldur-bosalt + VPS batch + finalize
// =========================================================

void drawTimelapseScreen() {
  uint32_t now  = millis();
  uint32_t rem  = (g_tlNextShot > now) ? (g_tlNextShot - now) / 1000 : 0;
  int      mins = rem / 60;
  int      secs = rem % 60;

  u8g2.clearBuffer();
  drawHeader();
  u8g2.setFont(u8g2_font_6x10_tr);

  char l1[24];
  snprintf(l1, sizeof(l1), "TL #%d", g_tlTotalFrames + g_tlCount);
  drawTextCenter(l1, 11);

  char l2[24];
  if (mins > 0) snprintf(l2, sizeof(l2), "Sonraki:%d:%02d", mins, secs);
  else          snprintf(l2, sizeof(l2), "Sonraki: %ds", (int)rem);
  drawTextCenter(l2, 21);

  u8g2.setFont(u8g2_font_4x6_tr);
  u8g2.drawStr(1, 31, "3x:Bitir+Gonder");
  u8g2.setFont(u8g2_font_6x10_tr);
  u8g2.sendBuffer();
}

// =========================================================
//  UPLOAD ANİMASYONU
//  Gonderim donguleri icerisinde cagrilir.
//  Her cagrida 42ms gecmediyse hic bir sey yapmaz (non-blocking).
// =========================================================

void drawUploadAnim() {
  uint32_t now = millis();
  if (now - g_uploadAnimLast < UPLOAD_ANIM_DELAY) return;
  g_uploadAnimLast = now;
  u8g2.clearBuffer();
  u8g2.drawBitmap(48, 0, 4, 32, uploadFrames[g_uploadAnimFrame]);
  u8g2.sendBuffer();
  g_uploadAnimFrame = (g_uploadAnimFrame + 1) % UPLOAD_ANIM_COUNT;
}

// =========================================================
//  TİMELAPSE GÜÇ YÖNETİMİ
//  Bosta: WiFi kes + CPU 80MHz → ~15mA
//  Aktif: WiFi baglan + CPU 240MHz → normal guc
// =========================================================

void tlEnterLowPower() {
  if (g_tlLowPower) return;
  // WiFi modemini tamamen kapat (en buyuk guç kazanimi)
  WiFi.disconnect(true);
  WiFi.mode(WIFI_OFF);
  // CPU 80MHz'e duşur (tap algilama ve I2S icin yeterli)
  setCpuFrequencyMhz(80);
  g_tlLowPower = true;
  Serial.println("TL: Dusuk guc modu → 80MHz, WiFi OFF (~15mA)");
}

void tlExitLowPower() {
  if (!g_tlLowPower) return;
  // CPU once 240MHz'e dondur (WiFi stack daha stabil olsun)
  setCpuFrequencyMhz(240);
  // WiFi yeniden baslat
  WiFi.mode(WIFI_STA);
  WiFi.setSleep(false);
  WiFi.begin(ssid, password);
  Serial.print("TL: Normal guc → 240MHz, WiFi baglaniyor");
  uint32_t t = millis();
  while (WiFi.status() != WL_CONNECTED && millis() - t < 12000) {
    delay(200); Serial.print(".");
    yield();
  }
  Serial.println(WiFi.status() == WL_CONNECTED ? " OK" : " HATA");
  g_tlLowPower = false;
}

void startTimelapse() {
  if (!psramAvail) {
    showStatusMsg("TL HATA", "PSRAM gerekli!");
    delay(2000); currentAppMode = MAIN_MENU; drawMainMenu(); return;
  }
  g_tlBufs  = (uint8_t**)ps_malloc(TL_BATCH_FRAMES * sizeof(uint8_t*));
  g_tlSizes = (size_t*)  ps_malloc(TL_BATCH_FRAMES * sizeof(size_t));
  if (!g_tlBufs || !g_tlSizes) {
    showStatusMsg("TL HATA", "Bellek yok!");
    delay(2000); currentAppMode = MAIN_MENU; drawMainMenu(); return;
  }
  memset(g_tlBufs,  0, TL_BATCH_FRAMES * sizeof(uint8_t*));
  memset(g_tlSizes, 0, TL_BATCH_FRAMES * sizeof(size_t));
  g_tlCount       = 0;
  g_tlTotalFrames = 0;
  g_tlLowPower    = false;
  g_tlNextShot    = millis() + 5000;  // ilk frame 5 sn sonra (hazirlik)
  g_tlOledUntil   = millis() + TL_OLED_ON_MS;
  u8g2.setPowerSave(0);
  showStatusMsg("TIMELAPSE", "2dk aralikla");
  delay(1200);
  drawTimelapseScreen();
  Serial.println("Timelapse basladi.");
}

void stopTimelapse(bool doFinalize) {
  tlExitLowPower();  // CPU 240MHz + WiFi bağlan (dusuk guçteyse)
  u8g2.setPowerSave(0);
  if (doFinalize) {
    showStatusMsg("Gonderiliyor...", "VPS isliyor...");
    bool ok = sendTlFinalize();
    showStatusMsg(ok ? "Telegram OK!" : "Gonderim Hata", "");
    delay(2000);
  }
  // PSRAM temizle
  if (g_tlBufs) {
    for (int i = 0; i < g_tlCount; i++) if (g_tlBufs[i]) free(g_tlBufs[i]);
    free(g_tlBufs); g_tlBufs = NULL;
  }
  if (g_tlSizes) { free(g_tlSizes); g_tlSizes = NULL; }
  g_tlCount = 0; g_tlTotalFrames = 0; g_tlOledUntil = 0;
  sensor_t* s = esp_camera_sensor_get();
  if (s) s->set_framesize(s, psramAvail ? FRAMESIZE_VGA : FRAMESIZE_QVGA);
  currentAppMode = MAIN_MENU;
  drawMainMenu();
  Serial.println("Timelapse durduruldu.");
}

void captureTimelapseFrame() {
  if (g_tlCount >= TL_BATCH_FRAMES) return;
  u8g2.setPowerSave(0);
  char buf[24];
  snprintf(buf, sizeof(buf), "Frame #%d", g_tlTotalFrames + g_tlCount + 1);
  showStatusMsg("Cekiliyor...", buf);

  sensor_t* s = esp_camera_sensor_get();
  if (s) s->set_framesize(s, TL_FRAMESIZE);
  delay(300);  // ilk oturma süresi

  // Isınma kareleri (5x): UXGA maksimum çözünürlük → en büyük akim sıçraması.
  // 5 flush frame ile güç tüketimi yumuşak rampalanır → reset önlenir.
  for (int i = 0; i < 5; i++) {
    camera_fb_t* flush = esp_camera_fb_get();
    if (flush) esp_camera_fb_return(flush);
    delay(60);
  }

  camera_fb_t* fb = esp_camera_fb_get();
  if (fb) {
    uint8_t* mem = (uint8_t*)ps_malloc(fb->len);
    if (mem) {
      memcpy(mem, fb->buf, fb->len);
      g_tlBufs[g_tlCount]  = mem;
      g_tlSizes[g_tlCount] = fb->len;
      g_tlCount++;
      Serial.printf("TL frame #%d: %u KB\n", g_tlTotalFrames + g_tlCount, fb->len / 1024);
    } else {
      Serial.println("TL: PSRAM yetmedi, frame atlandi!");
    }
    // ÖNEMLİ: set_framesize ÖNCE (fb tutuluyken DMA duruyor), fb_return SONRA çağrılmalı.
    // Ters sırada: fb_return → DMA TL_FRAMESIZE'da başlar → set_framesize çakışır → RESET.
    if (s) {
      s->set_framesize(s, psramAvail ? FRAMESIZE_VGA : FRAMESIZE_QVGA);
      delay(100);
    }
    esp_camera_fb_return(fb);
  } else {
    // fb alınamadıysa DMA çalışmıyor, yine de framesize'i geri al
    if (s) s->set_framesize(s, psramAvail ? FRAMESIZE_VGA : FRAMESIZE_QVGA);
  }

  g_tlOledUntil = millis() + TL_OLED_ON_MS;
  drawTimelapseScreen();
}

bool sendTlBatch() {
  if (g_tlCount == 0) return true;
  Serial.printf("TL Batch gonderiliyor: %d frame...\n", g_tlCount);

  if (WiFi.status() != WL_CONNECTED) {
    WiFi.reconnect();
    uint32_t t = millis();
    while (WiFi.status() != WL_CONNECTED && millis() - t < 10000) { delay(200); yield(); }
    if (WiFi.status() != WL_CONNECTED) { Serial.println("TL: WiFi yok!"); return false; }
  }

  WiFiClient client;
  bool connected = false;
  for (int a = 1; a <= 3 && !connected; a++) {
    connected = client.connect(vps_host.c_str(), vps_port);
    if (!connected) delay(600);
  }
  if (!connected) { Serial.println("TL: VPS baglantisi kurulamadi!"); return false; }

  const String boundary = "TLBATCH987";
  const String head = "--" + boundary +
    "\r\nContent-Disposition: form-data; name=\"files\"; filename=\"frame.jpg\"\r\n"
    "Content-Type: image/jpeg\r\n\r\n";
  const String tail     = "\r\n";
  const String endBound = "--" + boundary + "--\r\n";

  long totalLen = 0;
  for (int i = 0; i < g_tlCount; i++) totalLen += head.length() + g_tlSizes[i] + tail.length();
  totalLen += endBound.length();

  client.println("POST /timelapse_batch HTTP/1.1");
  client.println("Host: " + vps_host);
  client.println("Content-Type: multipart/form-data; boundary=" + boundary);
  client.print("Content-Length: "); client.println(totalLen);
  client.println("Connection: close");
  client.println();

  for (int i = 0; i < g_tlCount; i++) {
    client.print(head);
    size_t sent = 0;
    while (sent < g_tlSizes[i]) {
      size_t chunk   = min((size_t)2048, g_tlSizes[i] - sent);
      size_t written = client.write(g_tlBufs[i] + sent, chunk);
      if (written > 0) sent += written; else delay(10);
      drawUploadAnim();  // gonderim sirasinda animasyon
      yield();
    }
    client.print(tail);
  }
  client.print(endBound);

  bool ok = false;
  long start = millis();
  while ((client.connected() || client.available()) && millis() - start < 30000) {
    if (client.available()) {
      String line = client.readStringUntil('\n');
      if (line.indexOf("200 OK") >= 0) ok = true;
    }
    drawUploadAnim();  // yanit beklerken animasyon
    yield();
  }
  client.stop();

  if (ok) {
    g_tlTotalFrames += g_tlCount;
    for (int i = 0; i < g_tlCount; i++) { if (g_tlBufs[i]) { free(g_tlBufs[i]); g_tlBufs[i] = NULL; } }
    g_tlCount = 0;
    Serial.printf("TL Batch OK: toplam %d frame gonderildi.\n", g_tlTotalFrames);
  } else {
    Serial.println("TL Batch HATA!");
  }
  return ok;
}

bool sendTlFinalize() {
  // Once kalan frameleri gonder
  if (g_tlCount > 0) {
    showStatusMsg("Batch gonder...", "Bekleyin...");
    sendTlBatch();
  }
  if (g_tlTotalFrames == 0) {
    showStatusMsg("Timelapse bos", "Hic frame yok");
    delay(2000);
    return false;
  }
  if (WiFi.status() != WL_CONNECTED) {
    WiFi.reconnect();
    uint32_t t = millis();
    while (WiFi.status() != WL_CONNECTED && millis() - t < 10000) { delay(200); yield(); }
    if (WiFi.status() != WL_CONNECTED) return false;
  }

  showStatusMsg("Finalize...", "VPS video yapiyor");
  Serial.printf("TL Finalize: %d frame → video\n", g_tlTotalFrames);

  WiFiClient client;
  if (!client.connect(vps_host.c_str(), vps_port)) return false;

  client.println("POST /timelapse_finalize HTTP/1.1");
  client.println("Host: " + vps_host);
  client.println("Content-Length: 0");
  client.println("Connection: close");
  client.println();

  bool ok = false;
  long start = millis();
  while ((client.connected() || client.available()) && millis() - start < 120000) {
    if (client.available()) {
      String line = client.readStringUntil('\n');
      if (line.indexOf("200 OK") >= 0) ok = true;
      if (line.length() > 2) Serial.println(line);
    }
    drawUploadAnim();  // FFmpeg isleme + Telegram gonderme sirasinda animasyon
    yield();
  }
  client.stop();
  Serial.printf("TL Finalize: %s\n", ok ? "OK" : "HATA");
  return ok;
}

void runTimelapse() {
  static uint32_t lastDraw = 0;
  uint32_t now = millis();

  // OLED guc yonetimi
  if (g_tlOledUntil > 0) {
    if (now > g_tlOledUntil) {
      g_tlOledUntil = 0;
      u8g2.setPowerSave(1);   // OLED kapat
      tlEnterLowPower();      // WiFi kes + CPU 80MHz → ~15mA bosta
    } else if (now - lastDraw > 500) {
      lastDraw = now;
      drawTimelapseScreen();  // 2x/sn guncelle
    }
  }

  // Frame vakti geldi mi?
  if (now < g_tlNextShot) return;

  // ── Dusuk gucten cik (CPU 240MHz + WiFi baglan) ─────────
  if (g_tlLowPower) {
    u8g2.setPowerSave(0);
    showStatusMsg("Uykudan cikiyor", "WiFi baglaniyor..");
    tlExitLowPower();
  }

  // ── Frame cek ──────────────────────────────────────────
  // Sonraki vakti ONCE ayarla: capture suresi (1-2sn) hesaba katilir
  g_tlNextShot = now + TL_INTERVAL_MS;
  captureTimelapseFrame();

  // ── Batch doldu mu? → gonder (capture'dan hemen sonra) ─
  // Bir sonraki frame TL_INTERVAL_MS (2dk) sonra — gonderim icin bol zaman var
  if (g_tlCount >= TL_BATCH_FRAMES) {
    u8g2.setPowerSave(0);
    showStatusMsg("Batch gonder...", "Lutfen bekle...");
    bool ok = sendTlBatch();
    Serial.printf("TL Batch sonucu: %s\n", ok ? "OK" : "HATA");
    g_tlOledUntil = millis() + TL_OLED_ON_MS;  // durumu goster
  }
}

// =========================================================
//  VOICE MODE EKRANI
// =========================================================

void drawVoiceScreen() {
  u8g2.clearBuffer();
  drawHeader();
  u8g2.setFont(u8g2_font_6x10_tr);
  drawTextCenter("VOICE MODE", 12);
  u8g2.setFont(u8g2_font_5x7_tr);
  drawTextCenter("1x:Dinle  2x:Cik", 23);
  // Mikrofon ikonu (kucuk)
  u8g2.drawCircle(64, 29, 2);
  u8g2.drawLine(64, 31, 64, 32);
  u8g2.setFont(u8g2_font_6x10_tr);
  u8g2.sendBuffer();
}

// =========================================================
//  CLASSIC KAMERA MODU
// =========================================================

void drawClassicViewfinder() {
  u8g2.clearBuffer();
  drawHeader();
  u8g2.setFont(u8g2_font_6x10_tr);
  drawTextCenter("CLASSIC", 13);
  u8g2.setFont(u8g2_font_4x6_tr);
  drawTextCenter("1x:Photo  2x:Back", 25);
  u8g2.setFont(u8g2_font_6x10_tr);
  u8g2.sendBuffer();
}

void drawClassicDone() {
  u8g2.clearBuffer();
  drawHeader();
  u8g2.setFont(u8g2_font_6x10_tr);
  drawTextCenter(classicLastOk ? "Photo Sent!" : "Send Failed", 12);
  drawTextCenter(classicLastOk ? "Telegram OK" : "Check WiFi", 23);
  u8g2.setFont(u8g2_font_4x6_tr);
  drawTextCenter("1x:Again  2x:Back", 31);
  u8g2.setFont(u8g2_font_6x10_tr);
  u8g2.sendBuffer();
}

bool sendPhotoToVPS(uint8_t* buf, size_t len) {
  if (WiFi.status() != WL_CONNECTED) return false;
  WiFiClient client;
  if (!client.connect(vps_host.c_str(), vps_port)) return false;

  const String boundary = "CLASSBND";
  const String head = "--" + boundary +
    "\r\nContent-Disposition: form-data; name=\"image\"; filename=\"photo.jpg\"\r\n"
    "Content-Type: image/jpeg\r\n\r\n";
  const String tail = "\r\n--" + boundary + "--\r\n";
  long totalLen = head.length() + len + tail.length();

  client.println("POST /send_photo HTTP/1.1");
  client.println("Host: " + vps_host);
  client.println("Content-Type: multipart/form-data; boundary=" + boundary);
  client.print("Content-Length: "); client.println(totalLen);
  client.println("Connection: close");
  client.println();
  client.print(head);

  size_t sent = 0;
  while (sent < len) {
    size_t chunk   = min((size_t)2048, len - sent);
    size_t written = client.write(buf + sent, chunk);
    if (written > 0) sent += written; else delay(10);
    yield();
  }
  client.print(tail);

  bool ok = false;
  long start = millis();
  while ((client.connected() || client.available()) && millis() - start < 15000) {
    if (client.available()) {
      String line = client.readStringUntil('\n');
      if (line.indexOf("200 OK") >= 0) ok = true;
    }
    yield();
  }
  client.stop();
  return ok;
}

void takeClassicPhoto() {
  // Her zaman geri sayim (ayardan bagimsiz klasik modda hep acik)
  if (!runCountdown(g_photoTimer ? 3 : 0, "PHOTO")) {
    drawClassicViewfinder();
    return;
  }
  showStatusMsg("Capturing...", "");

  sensor_t* s = esp_camera_sensor_get();
  if (s) {
    s->set_framesize(s, FRAMESIZE_SXGA);
    delay(300);  // ilk oturma süresi
  }

  // Isınma kareleri (5x): ani akim spike'ini engeller.
  // Kamera SXGA'ya gecince ilk kareler bozuk + güç tüketimi aniden yükselir.
  // Her kareyi okuyup atarak sensör güç tüketimini YAVAŞÇA rampaya alıyoruz.
  // Guard mod gibi → sıfırdan başlayan soğuk çekim yerine ısınmış kamera.
  for (int i = 0; i < 5; i++) {
    camera_fb_t* flush = esp_camera_fb_get();
    if (flush) esp_camera_fb_return(flush);
    delay(50);
  }

  camera_fb_t* fb = esp_camera_fb_get();
  if (!fb) {
    // Basarisizsa framesize'i geri al, ekrana yaz
    if (s) s->set_framesize(s, psramAvail ? FRAMESIZE_VGA : FRAMESIZE_QVGA);
    showStatusMsg("Capture Fail", "");
    delay(1500);
    drawClassicViewfinder();
    return;
  }

  showStatusMsg("Sending...", "Telegram");
  classicLastOk = sendPhotoToVPS(fb->buf, fb->len);

  // ÖNEMLİ: set_framesize ÖNCE, fb_return SONRA çağrılmalı.
  // fb tutuluyken kamera DMA'sı duruyor → set_framesize güvenli.
  // fb_return sonra çağrılırsa DMA hemen VGA modunda başlar (çakışma yok).
  // Ters sırada: fb_return → DMA SXGA'da başlar → set_framesize çakışır → RESET.
  if (s) {
    s->set_framesize(s, psramAvail ? FRAMESIZE_VGA : FRAMESIZE_QVGA);
    delay(100);  // sensör yeni boyuta geçsin
  }
  esp_camera_fb_return(fb);

  classicState = CS_DONE;
  drawClassicDone();
}

// =========================================================
//  VPS'E STREAM YUKLE
// =========================================================
bool uploadStreamToVPS(uint8_t** buffers, size_t* sizes, int count, int imgW, int imgH, int fps) {
  if (count == 0) return false;

  if (WiFi.status() != WL_CONNECTED) {
    showStatusMsg("WiFi yok", "Baglaniliyor...");
    WiFi.reconnect();
    uint32_t t = millis();
    while (WiFi.status() != WL_CONNECTED && millis() - t < 10000) { delay(200); yield(); }
    if (WiFi.status() != WL_CONNECTED) return false;
  }

  WiFiClient client;
  bool connected = false;
  for (int attempt = 1; attempt <= 3 && !connected; attempt++) {
    connected = client.connect(vps_host.c_str(), vps_port);
    if (!connected) { Serial.printf("VPS baglanti %d/3 basarisiz\n", attempt); delay(500); }
  }
  if (!connected) return false;

  const String boundary = "ESP32STREAMBND";
  const String head = "--" + boundary +
    "\r\nContent-Disposition: form-data; name=\"files\"; filename=\"frame.jpg\"\r\n"
    "Content-Type: image/jpeg\r\n\r\n";
  const String tail     = "\r\n";
  const String endBound = "--" + boundary + "--\r\n";

  long totalLen = 0;
  for (int i = 0; i < count; i++) totalLen += head.length() + sizes[i] + tail.length();
  totalLen += endBound.length();

  client.println("POST " + stream_url + " HTTP/1.1");
  client.println("Host: " + vps_host);
  client.println("Content-Type: multipart/form-data; boundary=" + boundary);
  client.print("Content-Length: ");  client.println(totalLen);
  client.print("X-Frame-Width: ");   client.println(imgW);
  client.print("X-Frame-Height: ");  client.println(imgH);
  client.print("X-Frame-FPS: ");     client.println(fps);
  client.println("Connection: close");
  client.println();

  bool sendOk = true;
  for (int i = 0; i < count && sendOk; i++) {
    client.print(head);
    size_t sent = 0;
    while (sent < sizes[i]) {
      size_t chunk   = min((size_t)2048, sizes[i] - sent);
      size_t written = client.write(buffers[i] + sent, chunk);
      if (written > 0) sent += written; else delay(10);
      drawUploadAnim();  // guard upload animasyonu
      yield();
    }
    client.print(tail);
  }

  if (!sendOk) { client.stop(); return false; }
  client.print(endBound);

  bool success = false;
  long start   = millis();
  while ((client.connected() || client.available()) && millis() - start < UPLOAD_TIMEOUT_MS) {
    if (client.available()) {
      String line = client.readStringUntil('\n');
      Serial.println(line);
      if (line.indexOf("200 OK") >= 0) success = true;
    }
    yield();
  }
  client.stop();
  Serial.printf("Upload %s: %d kare\n", success ? "OK" : "hata", count);
  return success;
}

// =========================================================
//  AI MODU
// =========================================================
void runAiMode() {
  showStatusMsg("AI ASSIST", "Capturing...");

  sensor_t* s = esp_camera_sensor_get();
  if (!s) {
    showStatusMsg("CAM ERROR!", "");
    delay(2000);
    currentAppMode = MAIN_MENU;
    drawMainMenu();
    return;
  }

  s->set_framesize(s, FRAMESIZE_UXGA);
  delay(300);  // ilk oturma süresi

  // Isınma kareleri (5x): ani akim spike'ini engeller + eski DMA karelerini temizler.
  // CAMERA_GRAB_WHEN_EMPTY modunda önceki çekimden kalan kare gelebilir;
  // flush ile hem eski veri hem de güç rampası sorunu çözülür.
  for (int i = 0; i < 5; i++) {
    camera_fb_t* flush = esp_camera_fb_get();
    if (flush) esp_camera_fb_return(flush);
    delay(60);
  }

  // Deklansor efekti (ekran kararma = foto cekiliyor)
  u8g2.clearBuffer();
  u8g2.drawBox(0, 0, 128, 32);
  u8g2.sendBuffer();
  delay(150);

  camera_fb_t* fb = esp_camera_fb_get();
  if (!fb) {
    if (s) s->set_framesize(s, psramAvail ? FRAMESIZE_VGA : FRAMESIZE_QVGA);
    showStatusMsg("CAPTURE FAIL", "");
    delay(2000);
    currentAppMode = MAIN_MENU;
    drawMainMenu();
    return;
  }

  showStatusMsg("Analyzing...", "Please wait");

  WiFiClient client;
  const String boundary = "AIBND";
  const String head = "--" + boundary +
    "\r\nContent-Disposition: form-data; name=\"image\"; filename=\"img.jpg\"\r\n"
    "Content-Type: image/jpeg\r\n\r\n";
  const String tail = "\r\n--" + boundary + "--\r\n";
  long totalLen = (long)head.length() + fb->len + tail.length();

  if (client.connect(vps_host.c_str(), vps_port)) {
    client.println("POST " + ai_url + " HTTP/1.1");
    client.println("Host: " + vps_host);
    client.println("Content-Type: multipart/form-data; boundary=" + boundary);
    client.print("Content-Length: "); client.println(totalLen);
    client.println("Connection: close");
    client.println();

    client.print(head);
    size_t sent = 0;
    while (sent < fb->len) {
      size_t chunk   = min((size_t)2048, fb->len - sent);
      size_t written = client.write(fb->buf + sent, chunk);
      if (written > 0) sent += written; else delay(10);
      yield();
    }
    client.print(tail);

    long     startTime   = millis();
    int      animFrame   = 0;
    uint32_t lastAnim    = 0;
    String   responseBody = "";
    bool     isBody      = false;

    while ((client.connected() || client.available()) && millis() - startTime < AI_TIMEOUT_MS) {
      while (client.available()) {
        String line = client.readStringUntil('\n');
        line.trim();
        if (isBody)          responseBody += line;
        else if (line == "") isBody = true;
      }
      
      uint32_t now = millis();
      if (now - lastAnim >= AI_ANIM_DELAY) {
        u8g2.clearBuffer();
        drawHeader();
        u8g2.drawBitmap(48, 0, 4, 32, aiFrames[animFrame]);
        u8g2.sendBuffer();
        animFrame = (animFrame + 1) % AI_ANIM_COUNT;
        lastAnim = now;
      }
      yield();
    }
    client.stop();

    DynamicJsonDocument doc(1024);
    DeserializationError err = deserializeJson(doc, responseBody);
    if (!err && doc.containsKey("result")) aiResult = doc["result"].as<String>();
    else { aiResult = "Parse Error"; Serial.println("JSON hatasi: " + responseBody); }
  } else {
    aiResult = "Network Error";
  }

  // ÖNEMLİ: set_framesize ÖNCE (fb tutuluyken DMA duruyor), fb_return SONRA çağrılmalı.
  // Ters sırada: fb_return → DMA UXGA'da başlar → set_framesize çakışır → RESET.
  // Ayrıca: UXGA'da bırakılırsa bir sonraki AI çekiminde ghost frame riski vardır.
  if (s) {
    s->set_framesize(s, psramAvail ? FRAMESIZE_VGA : FRAMESIZE_QVGA);
    delay(100);
  }
  esp_camera_fb_return(fb);

  currentAppMode = RESULT_VIEW;
  displayAiResult(aiResult);
}

// =========================================================
//  ARAYUZ
// =========================================================

void drawHeader() {
  // WiFi sinyal barları (sağ üst)
  if (WiFi.status() == WL_CONNECTED) {
    u8g2.drawBox(118, 5, 2, 2);   // kısa bar
    u8g2.drawBox(121, 3, 2, 4);   // orta bar
    u8g2.drawBox(124, 1, 2, 6);   // uzun bar
  } else {
    u8g2.drawLine(119, 1, 125, 6);
    u8g2.drawLine(125, 1, 119, 6);
  }
  // Tap flash: sol üst köşe mini göstergesi
  if (millis() - g_tapFlash < 150) {
    u8g2.drawDisc(3, 4, 3);
  }
}

void drawFooter() {
  // Ana menüde footer yok — pozisyon noktaları zaten drawMainMenu'de çiziliyor
  // Diğer modlarda küçük "2x:Back" ipucu göster
  if (currentAppMode != MAIN_MENU) {
    u8g2.setFont(u8g2_font_4x6_tr);
    u8g2.drawStr(1, 31, "2x:Back");
    u8g2.setFont(u8g2_font_6x10_tr);
  }
}

// Mode ikonları: her mod için 8x8 pixel art (DRAM'da, küçük)
// Sıra: GUARD, AI, CLASSIC, VOICE, TIMELAPSE, SETTINGS, SLEEP
static const uint8_t modeIcons[8][8] = {
  { 0x3C,0x7E,0xFF,0xFF,0xFF,0x7E,0x3C,0x18 }, // GUARD      — kalkan
  { 0x18,0x3C,0x66,0xFF,0xFF,0x66,0x3C,0x18 }, // AI         — altıgen/beyin
  { 0x00,0x3E,0x41,0x5D,0x5D,0x41,0x3E,0x00 }, // CLASSIC    — kamera lensi
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  { 0x00,0x18,0x3C,0x7E,0x7E,0x3C,0x18,0x00 }, // SLEEP      — ay
};

void drawMainMenu() {
  if (isScreenSaver) return;
  u8g2.clearBuffer();

  // ── Header: WiFi + tap flash (sağ üst köşe) ─────────────────
  drawHeader();

  // ── Sol ok (önceki mod varsa) ────────────────────────────────
  if (menuCursor > 0) {
    u8g2.setFont(u8g2_font_4x6_tr);
    u8g2.drawStr(2, 18, "<");
    // Önceki modun adından ilk 4 harf — solda küçük ipucu
    char prev[5]; strncpy(prev, menuOptions[menuCursor - 1], 4); prev[4] = '\0';
    u8g2.drawStr(8, 18, prev);
  }

  // ── Sağ ok (sonraki mod varsa) ───────────────────────────────
  if (menuCursor < MENU_ITEMS - 1) {
    u8g2.setFont(u8g2_font_4x6_tr);
    char nxt[5]; strncpy(nxt, menuOptions[menuCursor + 1], 4); nxt[4] = '\0';
    int nxtW = u8g2.getStrWidth(nxt);
    u8g2.drawStr(128 - nxtW - 8, 18, nxt);
    u8g2.drawStr(124, 18, ">");
  }

  // ── Orta: ikon + büyük mod adı ──────────────────────────────
  // 8×8 ikon: y=0..7, x=57 (tam merkez − 4)
  u8g2.drawBitmap(57, 1, 1, 8, modeIcons[menuCursor]);

  u8g2.setFont(u8g2_font_7x13B_tr);
  drawTextCenter(menuOptions[menuCursor], 22);

  // ── Alt: pozisyon noktaları ──────────────────────────────────
  // 7 nokta, aralarında 8px → toplam 6×8+3=51px, merkez x=64
  int dotsStartX = 64 - (MENU_ITEMS * 8) / 2 + 3;
  for (int i = 0; i < MENU_ITEMS; i++) {
    int dx = dotsStartX + i * 8;
    if (i == menuCursor) u8g2.drawDisc(dx, 29, 2);    // seçili → dolu daire
    else                 u8g2.drawCircle(dx, 29, 1);  // diğer → boş daire
  }

  u8g2.setFont(u8g2_font_6x10_tr);  // default font'a geri dön
  u8g2.sendBuffer();
}

void drawSecurityScreen() {
  u8g2.clearBuffer();
  drawHeader();
  drawTextCenter("GUARD MODE", 12);
  drawTextCenter("Watching...", 22);
  u8g2.setFont(u8g2_font_4x6_tr);
  u8g2.drawStr(1, 31, "3x:Stop");     // 3x tap ile durdur
  u8g2.setFont(u8g2_font_6x10_tr);
  u8g2.sendBuffer();
}

void buildAiLines(const String& result) {
  g_aiLineCount = 0;
  g_aiPage      = 0;
  u8g2.setFont(u8g2_font_5x7_tr);
  const int maxCPL = 24;
  String rem = result;
  while (rem.length() > 0 && g_aiLineCount < 12) {
    int    len  = min((int)rem.length(), maxCPL);
    String line = rem.substring(0, len);
    if ((int)rem.length() > maxCPL) {
      int lastSp = line.lastIndexOf(' ');
      if (lastSp > 0) line = line.substring(0, lastSp);
    }
    g_aiLines[g_aiLineCount++] = line;
    rem = rem.substring(line.length());
    rem.trim();
  }
  u8g2.setFont(u8g2_font_6x10_tr);
}

void renderAiPage() {
  u8g2.clearBuffer();
  u8g2.setFont(u8g2_font_5x7_tr);
  const int LPP = 4;
  int totalPages = max(1, (g_aiLineCount + LPP - 1) / LPP);
  int startLine  = g_aiPage * LPP;
  for (int i = 0; i < LPP; i++) {
    int idx = startLine + i;
    if (idx >= g_aiLineCount) break;
    int tw = u8g2.getStrWidth(g_aiLines[idx].c_str());
    int x  = max(0, (128 - tw) / 2);
    u8g2.setCursor(x, 7 + i * 8);
    u8g2.print(g_aiLines[idx].c_str());
  }
  if (totalPages > 1) {
    for (int p = 0; p < totalPages && p < 5; p++) {
      int dx = 128 - totalPages * 6 + p * 6 + 2;
      if (p == g_aiPage) u8g2.drawDisc(dx, 30, 2);
      else               u8g2.drawCircle(dx, 30, 2);
    }
  }
  u8g2.setFont(u8g2_font_6x10_tr);
  u8g2.sendBuffer();
}

void displayAiResult(const String& result) {
  buildAiLines(result);
  renderAiPage();
}

void drawTextCenter(const char* text, int y) {
  int tw = u8g2.getStrWidth(text);
  int x  = (128 - tw) / 2;
  if (x < 0) x = 0;
  u8g2.setCursor(x, y);
  u8g2.print(text);
}

void showStatusMsg(const char* line1, const char* line2) {
  u8g2.clearBuffer();
  drawHeader();
  if (line2 && strlen(line2) > 0) {
    drawTextCenter(line1, 12);
    drawTextCenter(line2, 22);
  } else {
    drawTextCenter(line1, 17);
  }
  u8g2.sendBuffer();
}

// =========================================================
//  IT SUPPORT MOD
//  USB HID klavye aracılığıyla PC'yi otomatik teshis eder.
//
//  Akış:
//    1. initMode(IT_MODE) → VPS'e kayıt → session ID al
//    2. Telegram'dan /e "sorun" gelince VPS haberdar eder
//    3. loop() → runItMode() her 2sn VPS'i poll eder
//    4. Komut gelince WIN+R → bootstrap komutu yaz
//    5. PC script'i VPS'ten indirir ve çalıştırır
//    6. PC veriyi doğrudan VPS'e POST atar
//    7. Gemini analiz → plan Telegram'a gelir
//    8. Teknisyen ✅ → fix aynı şekilde uygulanır
//    9. 3x tap → IT moddan çık
// =========================================================

void drawItScreen() {
  u8g2.clearBuffer();
  drawHeader();
  u8g2.setFont(u8g2_font_6x10_tr);
  drawTextCenter("IT SUPPORT", 12);

  if (g_itRegistered) {
    char buf[24];
    snprintf(buf, sizeof(buf), "#%s OK", g_itSessionId);
    drawTextCenter(buf, 22);
  } else {
    char buf[24];
    snprintf(buf, sizeof(buf), "VPS... %d", g_itRegisterRetryCount);
    drawTextCenter(buf, 22);
  }

  u8g2.setFont(u8g2_font_4x6_tr);
  u8g2.drawStr(1, 31, "3x:Cik");
  u8g2.setFont(u8g2_font_6x10_tr);
  u8g2.sendBuffer();
}

// =========================================================
//  VPS'e kayit — non-blocking, kisa timeout, retry destekli
//  Maksimum ~3sn blocking (connect 1.5sn + read 1.5sn)
//  Bu sure tap kacirsa bile, kullanici 3x tap'i tekrar yapabilir
// =========================================================
bool itRegisterVPS() {
  // Yeni session ID
  // Lowercase hex: VPS bootstrap'inda lowercase URL kullaniliyor (TR Q'da
  // uppercase typing daha cok ALT+code gerektirir, lowercase daha hizli)
  snprintf(g_itSessionId, sizeof(g_itSessionId), "%08x", (unsigned)esp_random());

  WiFiClient client;
  client.setTimeout(2);   // Genel timeout 2sn

  // Kisa connect timeout: 1500ms
  uint32_t cs = millis();
  if (!client.connect(vps_host.c_str(), vps_port, 1500)) {
    Serial.printf("IT: kayit connect hatasi (%ums)\n", (unsigned)(millis() - cs));
    return false;
  }

  char body[48];
  snprintf(body, sizeof(body), "{\"session_id\":\"%s\"}", g_itSessionId);
  int blen = strlen(body);

  client.printf(
    "POST /it_register HTTP/1.1\r\n"
    "Host: %s\r\n"
    "Content-Type: application/json\r\n"
    "Content-Length: %d\r\n"
    "Connection: close\r\n\r\n"
    "%s",
    vps_host.c_str(), blen, body
  );

  // Read deadline: 1500ms
  uint32_t deadline = millis() + 1500;
  bool ok = false;
  bool sawStatus = false;
  while (millis() < deadline) {
    if (client.available()) {
      String line = client.readStringUntil('\n');
      if (!sawStatus) {
        sawStatus = true;
        if (line.indexOf("200") >= 0) ok = true;
      }
      // Geri kalani goz ardi — body parse etmeye gerek yok
    } else if (!client.connected() && client.available() == 0) {
      break;
    }
    yield();
  }
  client.stop();

  if (ok) {
    g_itRegistered         = true;
    g_itRegisterRetryCount = 0;
    Serial.printf("IT: VPS kaydedildi #%s\n", g_itSessionId);
  } else {
    Serial.printf("IT: kayit yaniti hatali (sawStatus=%d)\n", (int)sawStatus);
  }
  return ok;
}

// =========================================================
//  Tek poll — komut gelirse type=... doner, yoksa "" doner
//  Maksimum ~3sn blocking
// =========================================================
String itPollVPS() {
  WiFiClient client;
  client.setTimeout(2);
  if (!client.connect(vps_host.c_str(), vps_port, 1500)) {
    return "";
  }

  char path[40];
  snprintf(path, sizeof(path), "/it_poll/%s", g_itSessionId);
  client.printf(
    "GET %s HTTP/1.1\r\nHost: %s\r\nConnection: close\r\n\r\n",
    path, vps_host.c_str()
  );

  String resp = "";
  bool   inBody = false;
  uint32_t deadline = millis() + 1500;
  while (millis() < deadline) {
    if (client.available()) {
      String line = client.readStringUntil('\n');
      if (!inBody) {
        // HTTP header sonu: '\r' satiri (CRLF -> '\n' okundu, '\r' kaldi)
        if (line.length() == 0 || line == "\r") inBody = true;
      } else {
        resp += line;
      }
    } else if (!client.connected() && client.available() == 0) {
      break;
    }
    yield();
  }
  client.stop();
  resp.trim();
  if (resp.length() == 0) return "";

  // JSON parse — bootstrap field'i yaklasik 254 char olabilir, buffer arttir
  StaticJsonDocument<1024> doc;
  if (deserializeJson(doc, resp) != DeserializationError::Ok) {
    Serial.printf("IT: poll JSON parse hata: %s\n", resp.substring(0, 80).c_str());
    return "";
  }
  if (doc["cmd"].isNull()) return "";

  const char* cmdType   = doc["cmd"]["type"] | "collect";
  const char* bootstrap = doc["bootstrap"]    | "";

  // Bootstrap'i global'e koy (runItMode typing pending state'inde kullanacak)
  g_itPendingBootstrap = String(bootstrap);

  Serial.printf("IT: Komut alindi: type=%s, bootstrap_len=%d\n",
                cmdType, g_itPendingBootstrap.length());
  return String(cmdType);
}

// =========================================================
//  loop() icinden cagrilir — state machine
//  HER state minimum blocking yapar; arada checkTap() calisabilir
// =========================================================
void runItMode() {
  uint32_t now = millis();

  // ── State 1: Kayit gerekli ─────────────────────────────
  if (g_itState == IT_S_NEED_REGISTER) {
    // 4 saniyede bir dene; tap'a yer birak
    if (now - g_itLastRegisterAttemptMs < 4000 && g_itLastRegisterAttemptMs != 0) {
      return;
    }
    g_itLastRegisterAttemptMs = now;

    if (WiFi.status() != WL_CONNECTED) {
      // WiFi yok - bekle, retry artir gostergesi olsun
      return;
    }

    g_itRegisterRetryCount++;
    drawItScreen();      // "VPS... N" goster

    if (itRegisterVPS()) {
      g_itState = IT_S_IDLE;
      drawItScreen();
    }
    // Basarisiz olsa bile state degismez, 4sn sonra tekrar denenecek
    return;
  }

  // ── State 2: Idle - periodic poll ──────────────────────
  if (g_itState == IT_S_IDLE) {
    if (now - g_itLastPollMs < 2000) return;
    g_itLastPollMs = now;

    if (WiFi.status() != WL_CONNECTED) return;

    String cmdType = itPollVPS();
    if (cmdType.length() > 0) {
      g_itPendingCmdType = cmdType;
      g_itState          = IT_S_TYPING_PENDING;
    }
    return;
  }

  // ── State 3: Typing pending - PC'ye yaz ────────────────
  if (g_itState == IT_S_TYPING_PENDING) {
    bool isTest = (g_itPendingCmdType == "test_keyboard");

    if (g_itPendingCmdType == "collect") {
      showStatusMsg("IT: Teshis", "Komut yaziliyor");
    } else if (g_itPendingCmdType == "fix") {
      showStatusMsg("IT: Fix", "Komut yaziliyor");
    } else if (isTest) {
      showStatusMsg("KLAVYE TEST", "Notepad acılıyor");
    } else {
      showStatusMsg("IT: Komut", g_itPendingCmdType.c_str());
    }
    delay(300);

    if (isTest) {
      itTypeKeyboardTest();
    } else {
      // VPS'ten gelen Base64 encoded bootstrap'i kullan
      if (g_itPendingBootstrap.length() == 0) {
        Serial.println("IT: HATA - bootstrap bos! VPS cevap formatini kontrol et.");
        showStatusMsg("IT HATA", "Bootstrap bos");
        delay(1500);
      } else {
        itTypeBootstrapOnPc(g_itPendingBootstrap);
      }
    }

    // Typing bitti - idle'a don. delay(3000) YOK!
    g_itPendingCmdType   = "";
    g_itPendingBootstrap = "";
    g_itState            = IT_S_IDLE;
    g_itLastPollMs       = millis();
    drawItScreen();
    return;
  }
}

// =========================================================
//  Bootstrap akisi (v3.28): Notepad → Clipboard → PowerShell
//
//  PowerShell konsolda ALT+code calismadigi icin once Notepad'de
//  komutu yaziyoruz (orada ALT+code calisir), Ctrl+A+C ile clipboard'a
//  aliyoruz, Notepad'i kapatip PowerShell'i aciyoruz, Ctrl+V ile paste.
//
//  Ctrl+A, Ctrl+C, Ctrl+V universal kisayollar (layout-bagimsiz).
// =========================================================
void itTypeBootstrapOnPc(const String& bootstrapCmd) {
  // ──── ADIM 1: ESC + Notepad ac ──────────────────────────
  g_HIDKbd.press(KEY_ESC);
  g_HIDKbd.releaseAll();
  delay(150);

  g_HIDKbd.press(KEY_LEFT_GUI);
  g_HIDKbd.press('r');
  delay(100);
  g_HIDKbd.releaseAll();
  delay(900);

  itTypeStringHID("notepad");
  delay(120);
  g_HIDKbd.write(KEY_RETURN);
  delay(2500);   // Notepad acilana kadar

  // ──── ADIM 2: Komutu Notepad'e yaz ──────────────────────
  // ALT+code burada calisir, ozel chars dogru basilir
  itTypeStringHID(bootstrapCmd);
  delay(300);

  // ──── ADIM 3: Ctrl+A select all → Ctrl+C copy ──────────
  g_HIDKbd.press(KEY_LEFT_CTRL);
  g_HIDKbd.press('a');
  delay(60);
  g_HIDKbd.releaseAll();
  delay(150);

  g_HIDKbd.press(KEY_LEFT_CTRL);
  g_HIDKbd.press('c');
  delay(60);
  g_HIDKbd.releaseAll();
  delay(300);

  // ──── ADIM 4: Notepad'i kapat (Alt+F4 → Tab → Enter) ───
  // Save dialog acilirsa: Tab moves Save → Don't Save, Enter aktive eder
  g_HIDKbd.press(KEY_LEFT_ALT);
  g_HIDKbd.press(KEY_F4);
  delay(60);
  g_HIDKbd.releaseAll();
  delay(800);   // Save dialog acilsin (varsa)

  g_HIDKbd.press(KEY_TAB);
  delay(60);
  g_HIDKbd.releaseAll();
  delay(120);
  g_HIDKbd.write(KEY_RETURN);
  delay(700);

  // ──── ADIM 5: Win+R → powershell → Enter ────────────────
  g_HIDKbd.press(KEY_LEFT_GUI);
  g_HIDKbd.press('r');
  delay(100);
  g_HIDKbd.releaseAll();
  delay(900);

  itTypeStringHID("powershell");
  delay(120);
  g_HIDKbd.write(KEY_RETURN);
  delay(2500);   // PS konsolu acilsin

  // ──── ADIM 6: Ctrl+V paste, Enter ───────────────────────
  g_HIDKbd.press(KEY_LEFT_CTRL);
  g_HIDKbd.press('v');
  delay(60);
  g_HIDKbd.releaseAll();
  delay(400);

  g_HIDKbd.write(KEY_RETURN);
  delay(50);

  Serial.printf("IT: Notepad+Clipboard akisi tamamlandi (%d karakter)\n",
                bootstrapCmd.length());
}

// =========================================================
//  HID TYPING — HIBRIT (v3.26, layout-bagimsiz)
//
//  Strateji:
//    - Lowercase a-z (i HARIC): direkt scancode (TR Q'da dogru)
//    - Digit 0-9: direkt scancode
//    - Space: direkt scancode
//    - i, I, uppercase A-Z, ozel karakterler (`-` `:` `/` `(` `)` `'` `.` vs.):
//      ALT+0XXX numpad code (Windows ANSI codepage, layout-bagimsiz)
//
//  Plain command (~80 char) ~7 saniyede yazilir. Tum karakterler dogru basilir.
// =========================================================

// 0..9 icin numpad scancode'lari (USBHIDKeyboard library tanimi)
static const uint8_t IT_KP_DIGITS[10] = {
  0xEA,  // 0 = KEY_KP_0
  0xE1, 0xE2, 0xE3, 0xE4, 0xE5, 0xE6, 0xE7, 0xE8, 0xE9,
};

// ALT+0XXX yontemi: layout-bagimsiz karakter basar
void itTypeAltCode(int ascii) {
  char digits[5];
  snprintf(digits, sizeof(digits), "%04d", ascii);

  g_HIDKbd.releaseAll();
  delay(20);

  g_HIDKbd.press(KEY_LEFT_ALT);
  delay(60);

  for (int i = 0; i < 4; i++) {
    int     d  = digits[i] - '0';
    uint8_t kp = IT_KP_DIGITS[d];
    g_HIDKbd.press(kp);
    delay(28);
    g_HIDKbd.release(kp);
    delay(28);
  }

  g_HIDKbd.release(KEY_LEFT_ALT);
  delay(55);
}

void itTypeStringHID(const String& str) {
  for (int i = 0; i < (int)str.length(); i++) {
    char c = str[i];

    // KRITIK: Her karakter oncesi state cleanup.
    // Yoksa ardisik ALT+code'larda modifier carryover race condition →
    // bazi karakterler (ozellikle uppercase chain icindeki) drop oluyor.
    g_HIDKbd.releaseAll();
    delay(12);

    if (c == '\n' || c == '\r') {
      g_HIDKbd.write(KEY_RETURN);
      delay(25);
      continue;
    }

    bool direct_safe = ((c >= 'a' && c <= 'z') && c != 'i') ||
                       (c >= '0' && c <= '9') ||
                       (c == ' ');

    if (direct_safe) {
      g_HIDKbd.print(c);
      delay(15);
    } else if ((unsigned char)c < 128) {
      itTypeAltCode((int)c);
    } else {
      itTypeAltCode((int)(unsigned char)c);
    }
  }
}

// =========================================================
//  KLAVYE TEST MODU (v3.20 yenilik)
//
//  Telegram'dan /test_typing yazilinca tetiklenir. ESP32:
//    1. WIN+R ile "notepad" yazip Notepad'i acar
//    2. Tum kritik ozel karakterleri ve bootstrap URL'sini yazar
//    3. Kullanici Notepad icerigini gozle dogrular
//
//  Beklenen cikti (hata YOK ise):
//    --- KLAVYE TEST v3.20 ---
//    HARFLER: abcdefghijklmnopqrstuvwxyz
//    BUYUKLER: ABCDEFGHIJKLMNOPQRSTUVWXYZ
//    DIGITS:  0123456789
//    OZELLER: - : / . ' ( ) = " * + , _ ? ; !
//    URL:     http://YOUR_VPS_IP:8003/it_script/AABBCCDD
//    KOMUT:   powershell -NoProfile -Command "iex (iwr 'URL').Content"
//    --- TEST BITTI ---
// =========================================================
void itTypeKeyboardTest() {
  Serial.println("IT: Klavye testi basliyor — Notepad aciliyor...");

  // ESC: onceki menu kapansin
  g_HIDKbd.press(KEY_ESC);
  g_HIDKbd.releaseAll();
  delay(200);

  // WIN+R → Run dialog
  g_HIDKbd.press(KEY_LEFT_GUI);
  g_HIDKbd.press('r');
  delay(100);
  g_HIDKbd.releaseAll();
  delay(900);

  // "notepad" yaz (sadece harf, layout-safe — i yok)
  itTypeStringHID("notepad");
  delay(150);

  // Enter → Notepad acilir
  g_HIDKbd.press(KEY_RETURN);
  delay(50);
  g_HIDKbd.releaseAll();

  delay(3000);   // Notepad acilana kadar bekle

  // Hibrit typing testi — tum kritik karakterler dogru cikmali
  String t =
    "--- KLAVYE TEST v3.28 (NOTEPAD+CLIPBOARD) ---\n"
    "HARFLER:  abcdefghijklmnopqrstuvwxyz\n"
    "BUYUKLER: ABCDEFGHIJKLMNOPQRSTUVWXYZ\n"
    "DIGITS:   0123456789\n"
    "OZELLER:  - : / . = + ' ( ) \" * , _ ?\n"
    "PLAIN INNER (asil komut):\n"
    "iex (iwr 'http://YOUR_VPS_IP:8003/it_script/abcd1234' -usebasicparsing).content\n"
    "--- TEST BITTI ---\n";

  itTypeStringHID(t);

  Serial.printf("IT: Klavye testi tamamlandi (%d karakter yazildi)\n", t.length());
}

// =========================================================

void showStartupAnimation() {
  for (int i = 0; i <= 128; i += 8) {
    u8g2.clearBuffer();
    u8g2.setFont(u8g2_font_8x13B_tr);
    drawTextCenter("SMART OS", 14);
    u8g2.setFont(u8g2_font_4x6_tr);
    drawTextCenter("v3.32", 24);
    u8g2.drawBox(0, 28, i, 3);
    u8g2.sendBuffer();
    delay(22);
  }
  u8g2.setFont(u8g2_font_6x10_tr);
  delay(400);
}

// =========================================================
//  UYKU MODU
//  Deep sleep kullanilmiyor: I2S mikrofon deep sleep'te calismaz.
//  CPU calismeye devam eder, WiFi/kamera kapanir.
//  Cift tap = ESP.restart() ile tam yeniden baslatma.
// =========================================================
void goToSleep() {
  showStatusMsg("Sleeping...", "2x tap: Wake");
  delay(800);
  u8g2.setPowerSave(1);
  hasPrevBlock = false;
  WiFi.disconnect(true);
  WiFi.mode(WIFI_OFF);
  Serial.println("Uyku: Cift tap bekliyor...");

  // Aktivasyon tapinin bitmesini bekle
  for (int i = 0; i < 5; i++) {
    micI2S.readBytes((char*)micBuf, sizeof(micBuf));
    delay(10);
  }

  while (checkTap() != 2) {
    delay(8);
  }

  Serial.println("Uyku: Uyandiriliyor...");
  ESP.restart();
}

// =========================================================
//  KAMERA BASLAT
// =========================================================
bool initCamera() {
  camera_config_t config;
  config.ledc_channel  = LEDC_CHANNEL_0;
  config.ledc_timer    = LEDC_TIMER_0;
  config.pin_d0        = Y2_GPIO_NUM;
  config.pin_d1        = Y3_GPIO_NUM;
  config.pin_d2        = Y4_GPIO_NUM;
  config.pin_d3        = Y5_GPIO_NUM;
  config.pin_d4        = Y6_GPIO_NUM;
  config.pin_d5        = Y7_GPIO_NUM;
  config.pin_d6        = Y8_GPIO_NUM;
  config.pin_d7        = Y9_GPIO_NUM;
  config.pin_xclk      = XCLK_GPIO_NUM;
  config.pin_pclk      = PCLK_GPIO_NUM;
  config.pin_vsync     = VSYNC_GPIO_NUM;
  config.pin_href      = HREF_GPIO_NUM;
  config.pin_sccb_sda  = SIOD_GPIO_NUM;
  config.pin_sccb_scl  = SIOC_GPIO_NUM;
  config.pin_pwdn      = PWDN_GPIO_NUM;
  config.pin_reset     = RESET_GPIO_NUM;
  config.xclk_freq_hz  = 20000000; // 20MHz: OV2640 icin optimal stabilite/fps dengesi
  config.pixel_format  = PIXFORMAT_JPEG;
  config.grab_mode     = CAMERA_GRAB_LATEST;  // Her zaman en yeni kare: ghost frame sorunu olmaz
  config.jpeg_quality  = 15;

  // CRITICAL: Init the camera with the LARGEST framesize any mode will
  // ever request (UXGA = 1600x1200 for AI/Timelapse). The esp32-camera
  // driver allocates DMA + frame buffers at init based on this size and
  // does NOT resize them when set_framesize() is called later. If we
  // initialize at VGA and a mode then jumps to UXGA, the DMA buffer
  // overflows on the next capture and the chip resets.
  // After init, we drop the sensor down to VGA for default operation.
  if (psramAvail) {
    config.frame_size  = FRAMESIZE_UXGA;        // pre-allocate for max
    config.fb_location = CAMERA_FB_IN_PSRAM;
    config.fb_count    = 1;
  } else {
    config.frame_size  = FRAMESIZE_QVGA;        // no PSRAM: stay small
    config.fb_location = CAMERA_FB_IN_DRAM;
    config.fb_count    = 1;
  }

  esp_err_t err = esp_camera_init(&config);
  if (err != ESP_OK) {
    g_camInitError = err;
    Serial.printf("Camera init error: 0x%x\n", err);
    return false;
  }
  g_camInitError = ESP_OK;

  sensor_t* s = esp_camera_sensor_get();
  if (s) {
    // Drop to VGA for default operation (Guard, idle).
    // Modes that need higher resolution will set_framesize() up themselves.
    if (psramAvail) s->set_framesize(s, FRAMESIZE_VGA);

    s->set_brightness(s, 0);
    s->set_contrast(s, 0);
    s->set_saturation(s, 0);
    s->set_whitebal(s, 1);
    s->set_awb_gain(s, 1);
    s->set_exposure_ctrl(s, 1);
    s->set_aec2(s, 1);
    s->set_gain_ctrl(s, 1);
  }

  Serial.println("Camera ready.");
  return true;
}

// =========================================================
//  YARDIMCI
// =========================================================
void reconnectWiFiIfNeeded() {
  static uint32_t lastCheck = 0;
  if (millis() - lastCheck < 10000) return;
  lastCheck = millis();
  if (WiFi.status() != WL_CONNECTED) {
    Serial.println("WiFi koptu, yeniden baglaniliyor...");
    WiFi.disconnect();
    WiFi.begin(ssid, password);
  }
}

// (OTA fonksiyonlari v3.32'de kaldirildi)
